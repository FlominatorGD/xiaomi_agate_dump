/dts-v1/;

/ {
	compatible = "mediatek,MT6893";
	model = "AGATE";

	__fixups__ {
		accdet = "/fragment@9:target:0\0/fragment@25:target:0";
		auxadc = "/fragment@34:target:0\0/fragment@35/__overlay__:io-channels:0";
		bat_gm30 = "/fragment@76:target:0";
		charger = "/fragment@74:target:0";
		chosen = "/fragment@3:target:0";
		cp_qc30 = "/fragment@81:target:0";
		dispsys_config = "/fragment@8:target:0\0/fragment@92:target:0";
		dsi0 = "/fragment@93:target:0";
		dsi_te = "/fragment@55:target:0";
		gamekey = "/fragment@31:target:0";
		goodix_fp = "/fragment@13:target:0";
		gpio = "/fragment@48:target:0";
		gpio_usage_mapping = "/fragment@47:target:0";
		gps = "/fragment@19:target:0";
		i2c0 = "/fragment@28:target:0\0/fragment@37:target:0\0/fragment@78:target:0";
		i2c1 = "/fragment@38:target:0";
		i2c11 = "/fragment@80:target:0";
		i2c2 = "/fragment@39:target:0\0/fragment@68:target:0";
		i2c3 = "/fragment@40:target:0";
		i2c4 = "/fragment@41:target:0\0/fragment@69:target:0\0/fragment@84:target:0";
		i2c5 = "/fragment@42:target:0";
		i2c6 = "/fragment@33:target:0\0/fragment@43:target:0";
		i2c7 = "/fragment@22:target:0\0/fragment@27:target:0\0/fragment@44:target:0";
		i2c8 = "/fragment@45:target:0\0/fragment@70:target:0";
		i2c9 = "/fragment@21:target:0\0/fragment@24:target:0\0/fragment@46:target:0\0/fragment@79:target:0";
		irq_nfc = "/fragment@50:target:0";
		irtx_pwm = "/fragment@10:target:0";
		kd_camera_hw1 = "/fragment@59:target:0\0/fragment@67:target:0";
		keypad = "/fragment@61:target:0";
		lk_charger = "/fragment@72:target:0";
		md1_sim1_hot_plug_eint = "/fragment@56:target:0";
		md_auxadc = "/fragment@35:target:0";
		mmc0 = "/fragment@4:target:0";
		mmc_fixed_1v8_io = "/fragment@1:target:0\0/fragment@4/__overlay__:vqmmc-supply:0";
		mmc_fixed_3v3 = "/fragment@0:target:0\0/fragment@4/__overlay__:vmmc-supply:0";
		mrdump_ext_rst = "/fragment@49:target:0";
		msdc0 = "/fragment@88:target:0";
		msdc1 = "/fragment@89:target:0";
		mt6315_6_regulator = "/fragment@87:target:0";
		mt6360_pmic = "/fragment@16:target:0";
		mt6360_pmu = "/fragment@15:target:0\0/fragment@75:target:0";
		mt6360_typec = "/fragment@17:target:0";
		mt_charger = "/fragment@73:target:0";
		mt_pmic_vcamio_ldo_reg = "/fragment@57:target:0\0/fragment@59/__overlay__:vcamio-supply:0\0/fragment@59/__overlay__:vcamio_sub-supply:0\0/fragment@59/__overlay__:vcamio_main2-supply:0\0/fragment@59/__overlay__:vcamaf-supply:0\0/fragment@59/__overlay__:vcamaf_main2-supply:0\0/fragment@65:target:0\0/fragment@67/__overlay__:cam0_vcamio-supply:0\0/fragment@67/__overlay__:cam1_vcamio-supply:0\0/fragment@67/__overlay__:cam2_vcamio-supply:0\0/fragment@67/__overlay__:cam3_vcamio-supply:0";
		mt_pmic_vfp_ldo_reg = "/fragment@12/__overlay__/fingerprint@0:vfp-supply:0";
		mt_pmic_vmch_ldo_reg = "/fragment@63:target:0\0/fragment@64/__overlay__/fts@0:avdd-supply:0";
		mt_pmic_vtp_ldo_reg = "/fragment@28/__overlay__/gt9886@5d:vtouch-supply:0\0/fragment@29/__overlay__/gt9896s@0:vtouch-supply:0\0/fragment@58:target:0\0/fragment@60/__overlay__:vtouch-supply:0\0/fragment@67/__overlay__:cam0_vcamaf-supply:0\0/fragment@67/__overlay__:cam2_vcamaf-supply:0";
		mtkfb = "/fragment@7:target:0\0/fragment@91:target:0";
		nfc_default = "/fragment@33/__overlay__/st21nfc@08:pinctrl-0:0";
		nfc_enable_active = "/fragment@33/__overlay__/st21nfc@08:pinctrl-1:4";
		nfc_enable_suspend = "/fragment@33/__overlay__/st21nfc@08:pinctrl-2:4";
		nfc_int_active = "/fragment@33/__overlay__/st21nfc@08:pinctrl-1:0";
		nfc_int_suspend = "/fragment@33/__overlay__/st21nfc@08:pinctrl-2:0";
		odm = "/fragment@5:target:0\0/fragment@71:target:0\0/fragment@85:target:0";
		pio = "/fragment@6:target:0\0/fragment@11:target:0\0/fragment@13/__overlay__:fpc,gpio_irq:0\0/fragment@13/__overlay__:interrupt-parent:0\0/fragment@14:target:0\0/fragment@15/__overlay__:mt6360,intr_gpio:0\0/fragment@17/__overlay__:mt6360pd,intr_gpio:0\0/fragment@18:target:0\0/fragment@20:target:0\0/fragment@21/__overlay__/aw8697_haptic@5a:reset-gpio:0\0/fragment@21/__overlay__/aw8697_haptic@5a:irq-gpio:0\0/fragment@22/__overlay__/aw8697_haptic@5a:reset-gpio:0\0/fragment@22/__overlay__/aw8697_haptic@5a:irq-gpio:0\0/fragment@23:target:0\0/fragment@26:target:0\0/fragment@27/__overlay__/cs35l41@40:reset-gpio:0\0/fragment@27/__overlay__/cs35l41@40:interrupt-parent:0\0/fragment@27/__overlay__/cs35l41@40:irq-gpio:0\0/fragment@27/__overlay__/cs35l41@42:reset-gpio:0\0/fragment@27/__overlay__/cs35l41@42:interrupt-parent:0\0/fragment@27/__overlay__/cs35l41@42:irq-gpio:0\0/fragment@28/__overlay__/gt9886@5d:interrupt-parent:0\0/fragment@28/__overlay__/gt9886@5d:goodix,reset-gpio:0\0/fragment@28/__overlay__/gt9886@5d:goodix,irq-gpio:0\0/fragment@29/__overlay__/gt9896s@0:goodix,reset-gpio:0\0/fragment@29/__overlay__/gt9896s@0:goodix,irq-gpio:0\0/fragment@30:target:0\0/fragment@31/__overlay__:key_left:0\0/fragment@31/__overlay__:hall_left:0\0/fragment@31/__overlay__:key_right:0\0/fragment@31/__overlay__:hall_right:0\0/fragment@32:target:0\0/fragment@33/__overlay__/st21nfc@08:gpio-irq-std:0\0/fragment@33/__overlay__/st21nfc@08:interrupt-parent:0\0/fragment@33/__overlay__/st21nfc@08:gpio-rst-std:0\0/fragment@47/__overlay__:GPIO_SIM1_HOT_PLUG:0\0/fragment@47/__overlay__:GPIO_SIM2_SCLK:0\0/fragment@47/__overlay__:GPIO_SIM2_SRST:0\0/fragment@47/__overlay__:GPIO_SIM2_SIO:0\0/fragment@47/__overlay__:GPIO_SIM1_SIO:0\0/fragment@47/__overlay__:GPIO_SIM1_SRST:0\0/fragment@47/__overlay__:GPIO_SIM1_SCLK:0\0/fragment@49/__overlay__:interrupt-parent:0\0/fragment@49/__overlay__:deb-gpios:0\0/fragment@50/__overlay__:interrupt-parent:0\0/fragment@51/__overlay__:interrupt-parent:0\0/fragment@52/__overlay__:interrupt-parent:0\0/fragment@53/__overlay__:interrupt-parent:0\0/fragment@54/__overlay__:interrupt-parent:0\0/fragment@55/__overlay__:interrupt-parent:0\0/fragment@62:target:0\0/fragment@64/__overlay__/fts@0:interrupt-parent:0\0/fragment@64/__overlay__/fts@0:fts,irq-gpio:0\0/fragment@64/__overlay__/fts@0:fts,reset-gpio:0\0/fragment@66:target:0\0/fragment@77:target:0\0/fragment@78/__overlay__/xmusb350-charger@35:interrupt-parent:0\0/fragment@78/__overlay__/xmusb350-charger@35:xm,xmusb350_rst_gpio:0\0/fragment@78/__overlay__/xmusb350-charger@35:xm,xmusb350_sda_gpio:0\0/fragment@78/__overlay__/xmusb350-charger@35:xm,xmusb350_scl_gpio:0\0/fragment@78/__overlay__/xmusb350-charger@35:mi,connect_therm:0\0/fragment@80/__overlay__/bq2597x-master@65:interrupt-parent:0\0/fragment@80/__overlay__/bq2597x-slave@66:interrupt-parent:0\0/fragment@80/__overlay__/ln8000-master@5B:interrupt-parent:0\0/fragment@80/__overlay__/ln8000-slave@51:interrupt-parent:0\0/fragment@85/__overlay__/testing-mode:status-gpio:0\0/fragment@86:target:0\0/fragment@90:target:0\0/fragment@93/__overlay__/panel1@0:te-gpios:0\0/fragment@93/__overlay__/panel1@0:reset-gpios:0\0/fragment@93/__overlay__/panel1@0:dvdd-gpios:0\0/fragment@93/__overlay__/panel1@0:mi,esd-err-irq-gpio:0";
		pmic_clock_buffer_ctrl = "/fragment@36:target:0";
		reserved_memory = "/fragment@2:target:0";
		smart_pa = "/fragment@54:target:0";
		spi1 = "/fragment@12:target:0";
		spi4 = "/fragment@29:target:0";
		spi6 = "/fragment@64:target:0";
		subpmic_pmu_eint = "/fragment@52:target:0";
		tcpc_pd = "/fragment@53:target:0";
		touch = "/fragment@51:target:0\0/fragment@60:target:0";
		usb0phy = "/fragment@83:target:0";
		usbpd_pm = "/fragment@82:target:0";
	};

	__local_fixups__ {

		fragment@10 {

			__overlay__ {
				pinctrl-0 = <0x00>;
				pinctrl-1 = <0x00>;
			};
		};

		fragment@13 {

			__overlay__ {
				pinctrl-0 = <0x00>;
				pinctrl-1 = <0x00>;
				pinctrl-2 = <0x00>;
				pinctrl-3 = <0x00>;
				pinctrl-4 = <0x00>;
			};
		};

		fragment@19 {

			__overlay__ {
				pinctrl-0 = <0x00>;
				pinctrl-1 = <0x00>;
				pinctrl-2 = <0x00>;
				pinctrl-3 = <0x00>;
				pinctrl-4 = <0x00>;
				pinctrl-5 = <0x00>;
				pinctrl-6 = <0x00>;
			};
		};

		fragment@21 {

			__overlay__ {

				aw8697_haptic@5a {
					pinctrl-0 = <0x00>;
					pinctrl-1 = <0x00>;
					pinctrl-2 = <0x00>;
				};
			};
		};

		fragment@22 {

			__overlay__ {

				aw8697_haptic@5a {
					pinctrl-0 = <0x00>;
					pinctrl-1 = <0x00>;
					pinctrl-2 = <0x00>;
				};
			};
		};

		fragment@24 {

			__overlay__ {

				et7480@42 {
					pinctrl-0 = <0x00>;
					pinctrl-1 = <0x00>;
				};
			};
		};

		fragment@25 {

			__overlay__ {
				et7480-i2c-handle = <0x00>;
			};
		};

		fragment@27 {

			__overlay__ {

				cs35l41@42 {
					pinctrl-0 = <0x00>;
					pinctrl-1 = <0x00>;
				};
			};
		};

		fragment@28 {

			__overlay__ {
				pinctrl-0 = <0x00>;
				pinctrl-1 = <0x00>;
				pinctrl-2 = <0x00>;
				pinctrl-3 = <0x00>;
				pinctrl-4 = <0x00>;
				pinctrl-5 = <0x00>;
			};
		};

		fragment@29 {

			__overlay__ {
				pinctrl-0 = <0x00>;
				pinctrl-1 = <0x00>;
				pinctrl-2 = <0x00>;
				pinctrl-3 = <0x00>;
				pinctrl-4 = <0x00>;
				pinctrl-5 = <0x00>;
			};
		};

		fragment@31 {

			__overlay__ {
				pinctrl-0 = <0x00 0x04>;
				pinctrl-1 = <0x00 0x04>;
			};
		};

		fragment@64 {

			__overlay__ {

				fts@0 {
					pinctrl-0 = <0x00 0x04>;
					pinctrl-1 = <0x00 0x04>;
					pinctrl-2 = <0x00>;
					pinctrl-3 = <0x00>;
					pinctrl-4 = <0x00>;
				};
			};
		};

		fragment@67 {

			__overlay__ {
				cam2_vcama-supply = <0x00>;
				cam2_vcamd-supply = <0x00>;
				cam3_vcama-supply = <0x00>;
				cam3_vcamd-supply = <0x00>;
				pinctrl-0 = <0x00>;
				pinctrl-1 = <0x00>;
				pinctrl-10 = <0x00>;
				pinctrl-11 = <0x00>;
				pinctrl-12 = <0x00>;
				pinctrl-13 = <0x00>;
				pinctrl-14 = <0x00>;
				pinctrl-15 = <0x00>;
				pinctrl-16 = <0x00>;
				pinctrl-17 = <0x00>;
				pinctrl-18 = <0x00>;
				pinctrl-19 = <0x00>;
				pinctrl-2 = <0x00>;
				pinctrl-20 = <0x00>;
				pinctrl-21 = <0x00>;
				pinctrl-22 = <0x00>;
				pinctrl-23 = <0x00>;
				pinctrl-24 = <0x00>;
				pinctrl-25 = <0x00>;
				pinctrl-26 = <0x00>;
				pinctrl-27 = <0x00>;
				pinctrl-28 = <0x00>;
				pinctrl-29 = <0x00>;
				pinctrl-3 = <0x00>;
				pinctrl-30 = <0x00>;
				pinctrl-31 = <0x00>;
				pinctrl-32 = <0x00>;
				pinctrl-33 = <0x00>;
				pinctrl-34 = <0x00>;
				pinctrl-35 = <0x00>;
				pinctrl-36 = <0x00>;
				pinctrl-37 = <0x00>;
				pinctrl-38 = <0x00>;
				pinctrl-39 = <0x00>;
				pinctrl-4 = <0x00>;
				pinctrl-40 = <0x00>;
				pinctrl-41 = <0x00>;
				pinctrl-42 = <0x00>;
				pinctrl-43 = <0x00>;
				pinctrl-44 = <0x00>;
				pinctrl-45 = <0x00>;
				pinctrl-46 = <0x00>;
				pinctrl-47 = <0x00>;
				pinctrl-48 = <0x00>;
				pinctrl-49 = <0x00>;
				pinctrl-5 = <0x00>;
				pinctrl-50 = <0x00>;
				pinctrl-51 = <0x00>;
				pinctrl-52 = <0x00>;
				pinctrl-53 = <0x00>;
				pinctrl-54 = <0x00>;
				pinctrl-55 = <0x00>;
				pinctrl-56 = <0x00>;
				pinctrl-57 = <0x00>;
				pinctrl-58 = <0x00>;
				pinctrl-59 = <0x00>;
				pinctrl-6 = <0x00>;
				pinctrl-60 = <0x00>;
				pinctrl-61 = <0x00>;
				pinctrl-62 = <0x00>;
				pinctrl-63 = <0x00>;
				pinctrl-64 = <0x00>;
				pinctrl-65 = <0x00>;
				pinctrl-7 = <0x00>;
				pinctrl-8 = <0x00>;
				pinctrl-9 = <0x00>;
			};
		};

		fragment@7 {

			__overlay__ {
				pinctrl-0 = <0x00>;
				pinctrl-1 = <0x00>;
				pinctrl-2 = <0x00>;
			};
		};

		fragment@78 {

			__overlay__ {

				xmusb350-charger@35 {
					pinctrl-0 = <0x00 0x04 0x08>;
					pinctrl-1 = <0x00 0x04 0x08>;
				};
			};
		};

		fragment@8 {

			__overlay__ {
				pinctrl-0 = <0x00>;
				pinctrl-1 = <0x00>;
				pinctrl-2 = <0x00>;
			};
		};

		fragment@80 {

			__overlay__ {

				bq2597x-master@65 {
					pinctrl-0 = <0x00 0x04>;
				};

				bq2597x-slave@66 {
					pinctrl-0 = <0x00 0x04>;
				};

				ln8000-master@5B {
					pinctrl-0 = <0x00 0x04>;
				};

				ln8000-slave@51 {
					pinctrl-0 = <0x00 0x04>;
				};
			};
		};

		fragment@85 {

			__overlay__ {

				testing-mode {
					pinctrl-0 = <0x00>;
				};
			};
		};

		fragment@91 {

			__overlay__ {
				pinctrl-0 = <0x00>;
				pinctrl-1 = <0x00>;
				pinctrl-2 = <0x00>;
				pinctrl-3 = <0x00>;
			};
		};

		fragment@92 {

			__overlay__ {
				pinctrl-0 = <0x00>;
				pinctrl-1 = <0x00>;
				pinctrl-2 = <0x00>;
				pinctrl-3 = <0x00>;
			};
		};

		fragment@93 {

			__overlay__ {

				panel1@0 {

					port {

						endpoint {
							remote-endpoint = <0x00>;
						};
					};
				};

				ports {

					port {

						endpoint {
							remote-endpoint = <0x00>;
						};
					};
				};
			};
		};
	};

	__symbols__ {
		aw8697_interrupt = "/fragment@20/__overlay__/aw8697_interrupt_active";
		aw8697_reset_high = "/fragment@20/__overlay__/aw8697_reset_reset";
		aw8697_reset_low = "/fragment@20/__overlay__/aw8697_reset_active";
		bq2597x_master_int_default = "/fragment@77/__overlay__/bq2597x_master_int_default";
		bq2597x_master_int_suspend = "/fragment@77/__overlay__/bq2597x_master_int_suspend";
		bq2597x_slave_int_default = "/fragment@77/__overlay__/bq2597x_slave_int_default";
		bq2597x_slave_int_suspend = "/fragment@77/__overlay__/bq2597x_slave_int_suspend";
		camera_main_af_mtk = "/fragment@39/__overlay__/camera_main_af@0c";
		camera_main_mtk = "/fragment@39/__overlay__/camera_main@10";
		camera_main_three_af_mtk = "/fragment@46/__overlay__/camera_main_three_af@0c";
		camera_main_two_af_mtk = "/fragment@45/__overlay__/camera_main_two_af@0c";
		camera_main_two_mtk = "/fragment@45/__overlay__/camera_main_two@2d";
		camera_pins_cam0_mclk_2ma = "/fragment@66/__overlay__/camera_pins_cam0_mclk_2ma";
		camera_pins_cam0_mclk_4ma = "/fragment@66/__overlay__/camera_pins_cam0_mclk_4ma";
		camera_pins_cam0_mclk_6ma = "/fragment@66/__overlay__/camera_pins_cam0_mclk_6ma";
		camera_pins_cam0_mclk_8ma = "/fragment@66/__overlay__/camera_pins_cam0_mclk_8ma";
		camera_pins_cam0_mclk_off = "/fragment@66/__overlay__/camera_pins_cam0_mclk_off";
		camera_pins_cam0_pnd_0 = "/fragment@66/__overlay__/cam0@2";
		camera_pins_cam0_pnd_1 = "/fragment@66/__overlay__/cam0@3";
		camera_pins_cam0_rst_0 = "/fragment@66/__overlay__/cam0@0";
		camera_pins_cam0_rst_1 = "/fragment@66/__overlay__/cam0@1";
		camera_pins_cam0_vcama_0 = "/fragment@66/__overlay__/cam0@vcam2";
		camera_pins_cam0_vcama_1 = "/fragment@66/__overlay__/cam0@vcam3";
		camera_pins_cam0_vcamd_0 = "/fragment@66/__overlay__/cam0@vcam0";
		camera_pins_cam0_vcamd_1 = "/fragment@66/__overlay__/cam0@vcam1";
		camera_pins_cam1_mclk_2ma = "/fragment@66/__overlay__/camera_pins_cam1_mclk_2ma";
		camera_pins_cam1_mclk_4ma = "/fragment@66/__overlay__/camera_pins_cam1_mclk_4ma";
		camera_pins_cam1_mclk_6ma = "/fragment@66/__overlay__/camera_pins_cam1_mclk_6ma";
		camera_pins_cam1_mclk_8ma = "/fragment@66/__overlay__/camera_pins_cam1_mclk_8ma";
		camera_pins_cam1_mclk_off = "/fragment@66/__overlay__/camera_pins_cam1_mclk_off";
		camera_pins_cam1_pnd_0 = "/fragment@66/__overlay__/cam1@2";
		camera_pins_cam1_pnd_1 = "/fragment@66/__overlay__/cam1@3";
		camera_pins_cam1_rst_0 = "/fragment@66/__overlay__/cam1@0";
		camera_pins_cam1_rst_1 = "/fragment@66/__overlay__/cam1@1";
		camera_pins_cam1_vcama_0 = "/fragment@66/__overlay__/cam1@vcam2";
		camera_pins_cam1_vcama_1 = "/fragment@66/__overlay__/cam1@vcam3";
		camera_pins_cam1_vcamd_0 = "/fragment@66/__overlay__/cam1@vcam0";
		camera_pins_cam1_vcamd_1 = "/fragment@66/__overlay__/cam1@vcam1";
		camera_pins_cam2_mclk_2ma = "/fragment@66/__overlay__/camera_pins_cam2_mclk_2ma";
		camera_pins_cam2_mclk_4ma = "/fragment@66/__overlay__/camera_pins_cam2_mclk_4ma";
		camera_pins_cam2_mclk_6ma = "/fragment@66/__overlay__/camera_pins_cam2_mclk_6ma";
		camera_pins_cam2_mclk_8ma = "/fragment@66/__overlay__/camera_pins_cam2_mclk_8ma";
		camera_pins_cam2_mclk_off = "/fragment@66/__overlay__/camera_pins_cam2_mclk_off";
		camera_pins_cam2_pnd_0 = "/fragment@66/__overlay__/cam2@2";
		camera_pins_cam2_pnd_1 = "/fragment@66/__overlay__/cam2@3";
		camera_pins_cam2_rst_0 = "/fragment@66/__overlay__/cam2@0";
		camera_pins_cam2_rst_1 = "/fragment@66/__overlay__/cam2@1";
		camera_pins_cam2_vcama_0 = "/fragment@66/__overlay__/cam2@vcam2";
		camera_pins_cam2_vcama_1 = "/fragment@66/__overlay__/cam2@vcam3";
		camera_pins_cam2_vcamd_0 = "/fragment@66/__overlay__/cam2@vcam0";
		camera_pins_cam2_vcamd_1 = "/fragment@66/__overlay__/cam2@vcam1";
		camera_pins_cam3_mclk_2ma = "/fragment@66/__overlay__/camera_pins_cam3_mclk_2ma";
		camera_pins_cam3_mclk_4ma = "/fragment@66/__overlay__/camera_pins_cam3_mclk_4ma";
		camera_pins_cam3_mclk_6ma = "/fragment@66/__overlay__/camera_pins_cam3_mclk_6ma";
		camera_pins_cam3_mclk_8ma = "/fragment@66/__overlay__/camera_pins_cam3_mclk_8ma";
		camera_pins_cam3_mclk_off = "/fragment@66/__overlay__/camera_pins_cam3_mclk_off";
		camera_pins_cam3_pnd_0 = "/fragment@66/__overlay__/cam3@2";
		camera_pins_cam3_pnd_1 = "/fragment@66/__overlay__/cam3@3";
		camera_pins_cam3_rst_0 = "/fragment@66/__overlay__/cam3@0";
		camera_pins_cam3_rst_1 = "/fragment@66/__overlay__/cam3@1";
		camera_pins_cam3_vcama_0 = "/fragment@66/__overlay__/cam3@vcam2";
		camera_pins_cam3_vcama_1 = "/fragment@66/__overlay__/cam3@vcam3";
		camera_pins_cam3_vcamd_0 = "/fragment@66/__overlay__/cam3@vcam0";
		camera_pins_cam3_vcamd_1 = "/fragment@66/__overlay__/cam3@vcam1";
		camera_pins_cam4_mclk_2ma = "/fragment@66/__overlay__/camera_pins_cam4_mclk_2ma";
		camera_pins_cam4_mclk_4ma = "/fragment@66/__overlay__/camera_pins_cam4_mclk_4ma";
		camera_pins_cam4_mclk_6ma = "/fragment@66/__overlay__/camera_pins_cam4_mclk_6ma";
		camera_pins_cam4_mclk_8ma = "/fragment@66/__overlay__/camera_pins_cam4_mclk_8ma";
		camera_pins_cam4_mclk_off = "/fragment@66/__overlay__/camera_pins_cam4_mclk_off";
		camera_pins_cam4_pnd_0 = "/fragment@66/__overlay__/cam4@2";
		camera_pins_cam4_pnd_1 = "/fragment@66/__overlay__/cam4@3";
		camera_pins_cam4_rst_0 = "/fragment@66/__overlay__/cam4@0";
		camera_pins_cam4_rst_1 = "/fragment@66/__overlay__/cam4@1";
		camera_pins_cam4_vcama_0 = "/fragment@66/__overlay__/cam4@vcam2";
		camera_pins_cam4_vcama_1 = "/fragment@66/__overlay__/cam4@vcam3";
		camera_pins_cam4_vcamd_0 = "/fragment@66/__overlay__/cam4@vcam0";
		camera_pins_cam4_vcamd_1 = "/fragment@66/__overlay__/cam4@vcam1";
		camera_pins_default = "/fragment@66/__overlay__/camdefault";
		camera_sub_mtk = "/fragment@41/__overlay__/camera_sub@10";
		camera_sub_two_mtk = "/fragment@45/__overlay__/camera_sub_two@1a";
		cs35l41_bottom = "/fragment@27/__overlay__/cs35l41@40";
		cs35l41_top = "/fragment@27/__overlay__/cs35l41@42";
		ctp_gt9896s_int_active = "/fragment@30/__overlay__/int1_active";
		ctp_gt9896s_int_suspend = "/fragment@30/__overlay__/int1_suspend";
		ctp_gt9896s_pins_default = "/fragment@30/__overlay__/pins_default";
		ctp_gt9896s_reset_active = "/fragment@30/__overlay__/reset1_active";
		ctp_gt9896s_reset_suspend = "/fragment@30/__overlay__/reset1_suspend";
		ctp_gt9896s_spi_mode = "/fragment@30/__overlay__/spimode_default";
		ctp_pins_default = "/fragment@30/__overlay__/eintdefault";
		ctp_ts_i2c_mode = "/fragment@30/__overlay__/i2cmode_default";
		ctp_ts_int_active = "/fragment@30/__overlay__/int_active";
		ctp_ts_int_as_gpio = "/fragment@30/__overlay__/int_high";
		ctp_ts_int_suspend = "/fragment@30/__overlay__/int_suspend";
		ctp_ts_reset_active = "/fragment@30/__overlay__/reset_active";
		ctp_ts_reset_suspend = "/fragment@30/__overlay__/reset_suspend";
		dp_switch_mtk = "/fragment@43/__overlay__/dp_switch@50";
		dsi_out = "/fragment@93/__overlay__/ports/port/endpoint";
		et7480 = "/fragment@24/__overlay__/et7480@42";
		ext_buck_vmddr_mtk = "/fragment@43/__overlay__/ext_buck_vmddr@61";
		fingerprint_default = "/fragment@14/__overlay__/state_default";
		fingerprint_eint_init = "/fragment@14/__overlay__/state_eint_init";
		fingerprint_reset_high = "/fragment@14/__overlay__/state_reset_high";
		fingerprint_reset_low = "/fragment@14/__overlay__/state_reset_low";
		fingerprint_spi_cs = "/fragment@14/__overlay__/state_spi_cs";
		gk_hall_act = "/fragment@32/__overlay__/gk_hall_act";
		gk_hall_sup = "/fragment@32/__overlay__/gk_hall_sup";
		gk_key_act = "/fragment@32/__overlay__/gk_key_act";
		gk_key_sup = "/fragment@32/__overlay__/gk_key_sup";
		gps_l1_lna_pins_dsp_ctrl = "/fragment@18/__overlay__/gps_l1_lna@1";
		gps_l1_lna_pins_oh = "/fragment@18/__overlay__/gps_l1_lna@2";
		gps_l1_lna_pins_ol = "/fragment@18/__overlay__/gps_l1_lna@0";
		gps_l5_lna_pins_dsp_ctrl = "/fragment@18/__overlay__/gps_l5_lna@1";
		gps_l5_lna_pins_oh = "/fragment@18/__overlay__/gps_l5_lna@2";
		gps_l5_lna_pins_ol = "/fragment@18/__overlay__/gps_l5_lna@0";
		gps_pins_default = "/fragment@18/__overlay__/gps_default";
		i2c_lcd_bias_mtk = "/fragment@43/__overlay__/i2c_lcd_bias@3e";
		irtx_gpio_led_default = "/fragment@11/__overlay__/irtx_gpio_led_def@gpio135";
		irtx_gpio_led_set = "/fragment@11/__overlay__/irtx_gpio_led_set@gpio135";
		led0 = "/fragment@5/__overlay__/led@0";
		led1 = "/fragment@5/__overlay__/led@1";
		led2 = "/fragment@5/__overlay__/led@2";
		led3 = "/fragment@5/__overlay__/led@3";
		led4 = "/fragment@5/__overlay__/led@4";
		led5 = "/fragment@5/__overlay__/led@5";
		led6 = "/fragment@5/__overlay__/led@6";
		mtk_camera_eeprom0 = "/fragment@68/__overlay__/camera_eeprom0@51";
		mtk_camera_eeprom1 = "/fragment@69/__overlay__/camera_eeprom1@51";
		mtk_camera_eeprom2 = "/fragment@70/__overlay__/camera_eeprom2@52";
		mtk_camera_eeprom3 = "/fragment@70/__overlay__/camera_eeprom3@50";
		mtkfb_pins_lcm_dsi_te = "/fragment@6/__overlay__/lcm_dsi_te";
		mtkfb_pins_lcm_err_flag = "/fragment@90/__overlay__/lcm_err_flag";
		mtkfb_pins_lcm_rst_out0_gpio = "/fragment@6/__overlay__/lcm_rst_out0_gpio";
		mtkfb_pins_lcm_rst_out1_gpio = "/fragment@6/__overlay__/lcm_rst_out1_gpio";
		nfc_mtk = "/fragment@43/__overlay__/nfc@08";
		panel_in = "/fragment@93/__overlay__/panel1@0/port/endpoint";
		rcv_gpio_hight = "/fragment@26/__overlay__/rcv_gpio_hight";
		rcv_gpio_low = "/fragment@26/__overlay__/rcv_gpio_low";
		subpmic_ldo_mtk = "/fragment@42/__overlay__/subpmic_ldo@64";
		subpmic_mtk = "/fragment@42/__overlay__/subpmic@34";
		subpmic_pmic_mtk = "/fragment@42/__overlay__/subpmic_pmic@1a";
		test_mode_irq56 = "/fragment@86/__overlay__/test_mode_irq56";
		thermal_message = "/fragment@71/__overlay__/thermal-message";
		ts_dvdd_disable = "/fragment@62/__overlay__/ts_dvdddisable";
		ts_dvdd_enable = "/fragment@62/__overlay__/ts_dvddenable";
		ts_int_active = "/fragment@62/__overlay__/ts_int_active";
		ts_int_suspend = "/fragment@62/__overlay__/ts_int_suspend";
		ts_release = "/fragment@62/__overlay__/ts_release";
		ts_reset_active = "/fragment@62/__overlay__/ts_reset_active";
		ts_reset_suspend = "/fragment@62/__overlay__/ts_reset_suspend";
		ts_spi_mode = "/fragment@62/__overlay__/ts_spimode";
		uart_gpio_disable = "/fragment@23/__overlay__/uart_gpio_disable@gpio101";
		uart_gpio_enable = "/fragment@23/__overlay__/uart_gpio_enable@gpio101";
		usb_c_pinctrl = "/fragment@5/__overlay__/usb_c_pinctrl";
		usb_type_c_mtk = "/fragment@42/__overlay__/usb_type_c@4e";
		vibrator0 = "/fragment@5/__overlay__/vibrator@0";
		wl2866d1_avdd1 = "/fragment@84/__overlay__/willsemi,ldo@28/on,wl2866d1@2";
		wl2866d1_avdd2 = "/fragment@84/__overlay__/willsemi,ldo@28/on,wl2866d1@3";
		wl2866d1_dvdd1 = "/fragment@84/__overlay__/willsemi,ldo@28/on,wl2866d1@0";
		wl2866d1_dvdd2 = "/fragment@84/__overlay__/willsemi,ldo@28/on,wl2866d1@1";
		wl2866d1_pm = "/fragment@84/__overlay__/willsemi,ldo@28";
		xmusb350_int_isp = "/fragment@77/__overlay__/xmusb350_int_isp";
		xmusb350_int_normal = "/fragment@77/__overlay__/xmusb350_int_normal";
		xmusb350_rst_isp = "/fragment@77/__overlay__/xmusb350_rst_isp";
		xmusb350_rst_normal = "/fragment@77/__overlay__/xmusb350_rst_normal";
		xmusb350_scl_isp = "/fragment@77/__overlay__/xmusb350_scl_isp";
		xmusb350_scl_normal = "/fragment@77/__overlay__/xmusb350_scl_normal";
		xmusb350_sda_isp = "/fragment@77/__overlay__/xmusb350_sda_isp";
		xmusb350_sda_normal = "/fragment@77/__overlay__/xmusb350_sda_normal";
	};

	fragment@0 {
		target = <0xffffffff>;

		__overlay__ {
			enable-active-high;
			regulator-always-on;
			regulator-max-microvolt = <0x325aa0>;
			regulator-min-microvolt = <0x325aa0>;
			regulator-name = "mmc_power";
			status = "okay";
		};
	};

	fragment@1 {
		target = <0xffffffff>;

		__overlay__ {
			enable-active-high;
			regulator-always-on;
			regulator-max-microvolt = <0x1b7740>;
			regulator-min-microvolt = <0x1b7740>;
			regulator-name = "mmc_io";
			status = "okay";
		};
	};

	fragment@10 {
		target = <0xffffffff>;

		__overlay__ {
			pinctrl-0 = <0x04>;
			pinctrl-1 = <0x05>;
			pinctrl-names = "irtx_gpio_led_default\0irtx_gpio_led_set";
			pwm_ch = <0x00>;
			status = "okay";
		};
	};

	fragment@11 {
		target = <0xffffffff>;

		__overlay__ {

			irtx_gpio_led_def@gpio135 {
				phandle = <0x04>;

				pins_cmd_dat {
					bias-disable;
					input-schmitt-enable = <0x00>;
					output-low;
					pinmux = <0x8700>;
					slew-rate = <0x01>;
				};
			};

			irtx_gpio_led_set@gpio135 {
				phandle = <0x05>;

				pins_cmd_dat {
					output-high;
					pinmux = <0x8701>;
					slew-rate = <0x01>;
				};
			};
		};
	};

	fragment@12 {
		target = <0xffffffff>;

		__overlay__ {
			#address-cells = <0x01>;
			#size-cells = <0x00>;

			fingerprint@0 {
				compatible = "goodix,goodix-fp";
				netlink-event = <0x1e>;
				power-type = <0x01>;
				reg = <0x00>;
				spi-max-frequency = <0x7a1200>;
				status = "okay";
				vfp-supply = <0xffffffff>;
			};
		};
	};

	fragment@13 {
		target = <0xffffffff>;

		__overlay__ {
			fpc,gpio_irq = <0xffffffff 0x0f 0x00>;
			interrupt-parent = <0xffffffff>;
			interrupts = <0x0f 0x01 0x0f 0x00>;
			pinctrl-0 = <0x06>;
			pinctrl-1 = <0x07>;
			pinctrl-2 = <0x08>;
			pinctrl-3 = <0x09>;
			pinctrl-4 = <0x0a>;
			pinctrl-names = "default\0reset_high\0reset_low\0eint_init\0spi_cs";
			status = "okay";
		};
	};

	fragment@14 {
		target = <0xffffffff>;

		__overlay__ {

			state_default {
				phandle = <0x06>;
			};

			state_eint_init {
				phandle = <0x09>;

				pins_cmd_dat {
					bias-pull-up = <0x66>;
					input-schmitt-enable;
					pinmux = <0xf00>;
					slew-rate = <0x00>;
				};
			};

			state_reset_high {
				phandle = <0x07>;

				pins_cmd_dat {
					output-high;
					pinmux = <0xe00>;
					slew-rate = <0x01>;
				};
			};

			state_reset_low {
				phandle = <0x08>;

				pins_cmd_dat {
					output-low;
					pinmux = <0xe00>;
					slew-rate = <0x01>;
				};
			};

			state_spi_cs {
				phandle = <0x0a>;

				pins_cmd_dat {
					bias-disable;
					pinmux = <0x9d01>;
					slew-rate = <0x00>;
				};
			};
		};
	};

	fragment@15 {
		target = <0xffffffff>;

		__overlay__ {
			mt6360,intr_gpio = <0xffffffff 0x18 0x00>;
			mt6360,intr_gpio_num = <0x18>;
		};
	};

	fragment@16 {
		target = <0xffffffff>;

		__overlay__ {
			pwr_off_seq = <0x4000202>;
		};
	};

	fragment@17 {
		target = <0xffffffff>;

		__overlay__ {
			mt6360pd,intr_gpio = <0xffffffff 0x19 0x00>;
			mt6360pd,intr_gpio_num = <0x19>;
		};
	};

	fragment@18 {
		target = <0xffffffff>;

		__overlay__ {

			gps_default {
				phandle = <0x0b>;
			};

			gps_l1_lna@0 {
				phandle = <0x0c>;

				pins_cmd_dat {
					output-low;
					pinmux = <0xa200>;
				};
			};

			gps_l1_lna@1 {
				phandle = <0x0d>;

				pins_cmd_dat {
					pinmux = <0xa202>;
				};
			};

			gps_l1_lna@2 {
				phandle = <0x0e>;

				pins_cmd_dat {
					output-high;
					pinmux = <0xa200>;
				};
			};

			gps_l5_lna@0 {
				phandle = <0x0f>;

				pins_cmd_dat {
					output-low;
					pinmux = <0xa300>;
				};
			};

			gps_l5_lna@1 {
				phandle = <0x10>;

				pins_cmd_dat {
					pinmux = <0xa302>;
				};
			};

			gps_l5_lna@2 {
				phandle = <0x11>;

				pins_cmd_dat {
					output-high;
					pinmux = <0xa300>;
				};
			};
		};
	};

	fragment@19 {
		target = <0xffffffff>;

		__overlay__ {
			pinctrl-0 = <0x0b>;
			pinctrl-1 = <0x0c>;
			pinctrl-2 = <0x0d>;
			pinctrl-3 = <0x0e>;
			pinctrl-4 = <0x0f>;
			pinctrl-5 = <0x10>;
			pinctrl-6 = <0x11>;
			pinctrl-names = "default\0gps_l1_lna_disable\0gps_l1_lna_dsp_ctrl\0gps_l1_lna_enable\0gps_l5_lna_disable\0gps_l5_lna_dsp_ctrl\0gps_l5_lna_enable";
			status = "okay";
		};
	};

	fragment@2 {
		target = <0xffffffff>;

		__overlay__ {
		};
	};

	fragment@20 {
		target = <0xffffffff>;

		__overlay__ {

			aw8697_interrupt_active {
				phandle = <0x14>;

				pins_cmd_dat {
					bias-pull-up;
					drive-strength = <0x02>;
					input-enable;
					pinmux = <0x1600>;
				};
			};

			aw8697_reset_active {
				phandle = <0x12>;

				pins_cmd_dat {
					bias-disable;
					drive-strength = <0x02>;
					output-low;
					pinmux = <0x8100>;
				};
			};

			aw8697_reset_reset {
				phandle = <0x13>;

				pins_cmd_dat {
					bias-disable;
					drive-strength = <0x02>;
					output-high;
					pinmux = <0x8100>;
				};
			};
		};
	};

	fragment@21 {
		target = <0xffffffff>;

		__overlay__ {
			status = "ok";

			aw8697_haptic@5a {
				compatible = "awinic,aw8697_haptic";
				irq-gpio = <0xffffffff 0x16 0x00>;
				pinctrl-0 = <0x12>;
				pinctrl-1 = <0x13>;
				pinctrl-2 = <0x14>;
				pinctrl-names = "aw8697_reset_reset\0aw8697_reset_active\0aw8697_interrupt_active";
				reg = <0x5a>;
				reset-gpio = <0xffffffff 0x81 0x00>;
				status = "ok";
				vib_bemf_config = <0x00 0x08 0x03 0xf8>;
				vib_bst_vol_default = <0x11>;
				vib_bst_vol_ram = <0x11>;
				vib_bst_vol_rtp = <0x11>;
				vib_bstdbg = <0x30 0xeb 0xd4 0x00 0x00 0x00>;
				vib_cont_drv_lev = <0x3c>;
				vib_cont_drv_lvl_ov = <0x3c>;
				vib_cont_num_brk = <0x03>;
				vib_cont_td = <0xef>;
				vib_cont_zc_thr = <0x8f8>;
				vib_effect_id_boundary = <0x0a>;
				vib_effect_max = <0xc5>;
				vib_f0_cali_percen = <0x07>;
				vib_f0_coeff = <0x104>;
				vib_f0_pre = <0x6a4>;
				vib_f0_trace_parameter = <0x05 0x03 0x02 0x0f>;
				vib_mode = <0x00>;
				vib_r_spare = <0x68>;
				vib_rtp_time = <0x14 0x14 0x14 0x14 0x14 0x14 0x14 0x14 0x4e20 0x3a98 0x3a98 0x4e20 0x61a8 0x3a98 0x7530 0x61a8 0x4e20 0x4e20 0x4e20 0x4e20 0x4e20 0x4e20 0x4e20 0x4e20 0x4e20 0x4e20 0x4e20 0x4e20 0x4e20 0x4e20 0x4e20 0x4e20 0x4e20 0x4e20 0x4e20 0x4e20 0x4e20 0x4e20 0x4e20 0x4e20 0x4e20 0x4e20 0x4e20 0x4e20 0x4e20 0x4e20 0x4e20 0x4e20 0x4e20 0x4e20 0x4e20 0x4e20 0x4e20 0x4e20 0x4e20 0x4e20 0x4e20 0x4e20 0x4e20 0x4e20 0x4e20 0x4e20 0x4e20 0x4e20 0x4e20 0x4e20 0x4e20 0x4e20 0x4e20 0x4e20 0x4e20 0x4e20 0x4e20 0x4e20 0x4e20 0x4e20 0x4e20 0x4e20 0x4e20 0x4e20 0x4e20 0x4e20 0x4e20 0x4e20 0x4e20 0x4e20 0x4e20 0x4e20 0x4e20 0x4e20 0x4e20 0x4e20 0x4e20 0x4e20 0x4e20 0x4e20 0x4e20 0x4e20 0x4e20 0x4e20 0x4e20 0x4e20 0x4e20 0x4e20 0x4e20 0x4e20 0x4e20 0x4e20 0x4e20 0x4e20 0x4e20 0x4e20 0x4e20 0x4e20 0x4e20 0x4e20 0x4e20 0x4e20 0x4e20 0x4e20 0x4e20 0x4e20 0x4e20 0x4e20 0x4e20 0x4e20 0x4e20 0x4e20 0x4e20 0x4e20 0x4e20 0x4e20 0x4e20 0x4e20 0x4e20 0x4e20 0x4e20 0x4e20 0x4e20 0x4e20 0x4e20 0x4e20 0x4e20 0x4e20 0x4e20 0x4e20 0x4e20 0x4e20 0x4e20 0x4e20 0x4e20 0x4e20 0x4e20 0x4e20 0x4e20 0x4e20 0x4e20 0x4e20 0x4e20 0x4e20 0x4e20 0x4e20 0x4e20 0x4e20 0x4e20 0x4e20 0x4e20 0x4e20 0x4e20 0x4e20 0x4e20 0x4e20 0x4e20 0x4e20 0x4e20>;
				vib_sw_brake = <0x2c>;
				vib_trig_config = <0x00 0x01 0x00 0x01 0x02 0x00 0x01 0x00 0x01 0x02 0x00 0x01 0x00 0x01 0x02>;
				vib_tset = <0x1a>;

				wf_0 {
					mtk,effect-id = <0x00>;
					mtk,wf-brake-pattern = <0x2010000>;
					mtk,wf-pattern = [3e 3e];
					mtk,wf-play-rate-us = <0x4e20>;
					mtk,wf-vmax-mv = <0xe10>;
				};

				wf_1 {
					mtk,effect-id = <0x01>;
					mtk,wf-brake-pattern = <0x3010000>;
					mtk,wf-pattern = [7e 3e];
					mtk,wf-play-rate-us = <0x4e20>;
					mtk,wf-vmax-mv = <0xe10>;
				};

				wf_2 {
					mtk,effect-id = <0x02>;
					mtk,wf-brake-pattern = <0x2010000>;
					mtk,wf-pattern = [7e 3e];
					mtk,wf-play-rate-us = <0x4e20>;
					mtk,wf-vmax-mv = <0xe10>;
				};

				wf_3 {
					mtk,effect-id = <0x03>;
					mtk,wf-brake-pattern = <0x2010000>;
					mtk,wf-pattern = [3e 3e];
					mtk,wf-play-rate-us = <0x4e20>;
					mtk,wf-vmax-mv = <0xe10>;
				};

				wf_4 {
					mtk,effect-id = <0x04>;
					mtk,wf-brake-pattern = <0x2010000>;
					mtk,wf-pattern = [3e 3e];
					mtk,wf-play-rate-us = <0x6d60>;
					mtk,wf-vmax-mv = <0xe10>;
				};

				wf_5 {
					mtk,effect-id = <0x05>;
					mtk,wf-brake-pattern = <0x3030100>;
					mtk,wf-pattern = [7e 7e 7e];
					mtk,wf-play-rate-us = <0x4e20>;
					mtk,wf-vmax-mv = <0xe10>;
				};

				wf_6 {
					mtk,effect-id = <0x06>;
					mtk,wf-brake-pattern = <0x2010000>;
					mtk,wf-pattern = [3e 3e];
					mtk,wf-play-rate-us = <0x4e20>;
					mtk,wf-vmax-mv = <0xe10>;
				};

				wf_7 {
					mtk,effect-id = <0x07>;
					mtk,wf-brake-pattern = <0x2010000>;
					mtk,wf-pattern = [3e 3e];
					mtk,wf-play-rate-us = <0x4e20>;
					mtk,wf-vmax-mv = <0xe10>;
				};

				wf_8 {
					mtk,effect-id = <0x08>;
					mtk,wf-brake-pattern = <0x2010000>;
					mtk,wf-pattern = [3e 3e];
					mtk,wf-play-rate-us = <0x4e20>;
					mtk,wf-vmax-mv = <0xe10>;
				};

				wf_9 {
					mtk,effect-id = <0x09>;
					mtk,wf-brake-pattern = <0x2010000>;
					mtk,wf-pattern = [3e 3e];
					mtk,wf-play-rate-us = <0x4e20>;
					mtk,wf-vmax-mv = <0xe10>;
				};
			};
		};
	};

	fragment@22 {
		target = <0xffffffff>;

		__overlay__ {
			status = "ok";

			aw8697_haptic@5a {
				compatible = "awinic,aw8697_haptic";
				irq-gpio = <0xffffffff 0x16 0x00>;
				pinctrl-0 = <0x12>;
				pinctrl-1 = <0x13>;
				pinctrl-2 = <0x14>;
				pinctrl-names = "aw8697_reset_reset\0aw8697_reset_active\0aw8697_interrupt_active";
				reg = <0x5a>;
				reset-gpio = <0xffffffff 0x81 0x00>;
				status = "ok";
				vib_bemf_config = <0x00 0x08 0x03 0xf8>;
				vib_bst_vol_default = <0x11>;
				vib_bst_vol_ram = <0x11>;
				vib_bst_vol_rtp = <0x11>;
				vib_bstdbg = <0x30 0xeb 0xd4 0x00 0x00 0x00>;
				vib_cont_drv_lev = <0x3c>;
				vib_cont_drv_lvl_ov = <0x3c>;
				vib_cont_num_brk = <0x03>;
				vib_cont_td = <0xef>;
				vib_cont_zc_thr = <0x8f8>;
				vib_effect_id_boundary = <0x0a>;
				vib_effect_max = <0xc5>;
				vib_f0_cali_percen = <0x07>;
				vib_f0_coeff = <0x104>;
				vib_f0_pre = <0x6a4>;
				vib_f0_trace_parameter = <0x05 0x03 0x02 0x0f>;
				vib_mode = <0x00>;
				vib_r_spare = <0x68>;
				vib_rtp_time = <0x14 0x14 0x14 0x14 0x14 0x14 0x14 0x14 0x4e20 0x3a98 0x3a98 0x4e20 0x61a8 0x3a98 0x7530 0x61a8 0x4e20 0x4e20 0x4e20 0x4e20 0x4e20 0x4e20 0x4e20 0x4e20 0x4e20 0x4e20 0x4e20 0x4e20 0x4e20 0x4e20 0x4e20 0x4e20 0x4e20 0x4e20 0x4e20 0x4e20 0x4e20 0x4e20 0x4e20 0x4e20 0x4e20 0x4e20 0x4e20 0x4e20 0x4e20 0x4e20 0x4e20 0x4e20 0x4e20 0x4e20 0x4e20 0x4e20 0x4e20 0x4e20 0x4e20 0x4e20 0x4e20 0x4e20 0x4e20 0x4e20 0x4e20 0x4e20 0x4e20 0x4e20 0x4e20 0x4e20 0x4e20 0x4e20 0x4e20 0x4e20 0x4e20 0x4e20 0x4e20 0x4e20 0x4e20 0x4e20 0x4e20 0x4e20 0x4e20 0x4e20 0x4e20 0x4e20 0x4e20 0x4e20 0x4e20 0x4e20 0x4e20 0x4e20 0x4e20 0x4e20 0x4e20 0x4e20 0x4e20 0x4e20 0x4e20 0x4e20 0x4e20 0x4e20 0x4e20 0x4e20 0x4e20 0x4e20 0x4e20 0x4e20 0x4e20 0x4e20 0x4e20 0x4e20 0x4e20 0x4e20 0x4e20 0x4e20 0x4e20 0x4e20 0x4e20 0x4e20 0x4e20 0x4e20 0x4e20 0x4e20 0x4e20 0x4e20 0x4e20 0x4e20 0x4e20 0x4e20 0x4e20 0x4e20 0x4e20 0x4e20 0x4e20 0x4e20 0x4e20 0x4e20 0x4e20 0x4e20 0x4e20 0x4e20 0x4e20 0x4e20 0x4e20 0x4e20 0x4e20 0x4e20 0x4e20 0x4e20 0x4e20 0x4e20 0x4e20 0x4e20 0x4e20 0x4e20 0x4e20 0x4e20 0x4e20 0x4e20 0x4e20 0x4e20 0x4e20 0x4e20 0x4e20 0x4e20 0x4e20 0x4e20 0x4e20 0x4e20 0x4e20 0x4e20 0x4e20 0x4e20 0x4e20 0x4e20 0x4e20 0x4e20 0x4e20>;
				vib_sw_brake = <0x2c>;
				vib_trig_config = <0x00 0x01 0x00 0x01 0x02 0x00 0x01 0x00 0x01 0x02 0x00 0x01 0x00 0x01 0x02>;
				vib_tset = <0x1a>;

				wf_0 {
					mtk,effect-id = <0x00>;
					mtk,wf-brake-pattern = <0x2010000>;
					mtk,wf-pattern = [3e 3e];
					mtk,wf-play-rate-us = <0x4e20>;
					mtk,wf-vmax-mv = <0xe10>;
				};

				wf_1 {
					mtk,effect-id = <0x01>;
					mtk,wf-brake-pattern = <0x3010000>;
					mtk,wf-pattern = [7e 3e];
					mtk,wf-play-rate-us = <0x4e20>;
					mtk,wf-vmax-mv = <0xe10>;
				};

				wf_2 {
					mtk,effect-id = <0x02>;
					mtk,wf-brake-pattern = <0x2010000>;
					mtk,wf-pattern = [7e 3e];
					mtk,wf-play-rate-us = <0x4e20>;
					mtk,wf-vmax-mv = <0xe10>;
				};

				wf_3 {
					mtk,effect-id = <0x03>;
					mtk,wf-brake-pattern = <0x2010000>;
					mtk,wf-pattern = [3e 3e];
					mtk,wf-play-rate-us = <0x4e20>;
					mtk,wf-vmax-mv = <0xe10>;
				};

				wf_4 {
					mtk,effect-id = <0x04>;
					mtk,wf-brake-pattern = <0x2010000>;
					mtk,wf-pattern = [3e 3e];
					mtk,wf-play-rate-us = <0x6d60>;
					mtk,wf-vmax-mv = <0xe10>;
				};

				wf_5 {
					mtk,effect-id = <0x05>;
					mtk,wf-brake-pattern = <0x3030100>;
					mtk,wf-pattern = [7e 7e 7e];
					mtk,wf-play-rate-us = <0x4e20>;
					mtk,wf-vmax-mv = <0xe10>;
				};

				wf_6 {
					mtk,effect-id = <0x06>;
					mtk,wf-brake-pattern = <0x2010000>;
					mtk,wf-pattern = [3e 3e];
					mtk,wf-play-rate-us = <0x4e20>;
					mtk,wf-vmax-mv = <0xe10>;
				};

				wf_7 {
					mtk,effect-id = <0x07>;
					mtk,wf-brake-pattern = <0x2010000>;
					mtk,wf-pattern = [3e 3e];
					mtk,wf-play-rate-us = <0x4e20>;
					mtk,wf-vmax-mv = <0xe10>;
				};

				wf_8 {
					mtk,effect-id = <0x08>;
					mtk,wf-brake-pattern = <0x2010000>;
					mtk,wf-pattern = [3e 3e];
					mtk,wf-play-rate-us = <0x4e20>;
					mtk,wf-vmax-mv = <0xe10>;
				};

				wf_9 {
					mtk,effect-id = <0x09>;
					mtk,wf-brake-pattern = <0x2010000>;
					mtk,wf-pattern = [3e 3e];
					mtk,wf-play-rate-us = <0x4e20>;
					mtk,wf-vmax-mv = <0xe10>;
				};
			};
		};
	};

	fragment@23 {
		target = <0xffffffff>;

		__overlay__ {

			uart_gpio_disable@gpio101 {
				phandle = <0x16>;

				pins_cmd_dat {
					bias-disable;
					output-high;
					pinmux = <0x6500>;
					slew-rate = <0x01>;
				};
			};

			uart_gpio_enable@gpio101 {
				phandle = <0x15>;

				pins_cmd_dat {
					bias-disable;
					output-low;
					pinmux = <0x6500>;
					slew-rate = <0x01>;
				};
			};
		};
	};

	fragment@24 {
		target = <0xffffffff>;

		__overlay__ {

			et7480@42 {
				compatible = "mediatek,et7480-audioswitch";
				phandle = <0x17>;
				pinctrl-0 = <0x15>;
				pinctrl-1 = <0x16>;
				pinctrl-names = "uart_enable\0uart_disable";
				reg = <0x42>;
				status = "ok";
			};
		};
	};

	fragment@25 {
		target = <0xffffffff>;

		__overlay__ {
			accdet-mic-mode = <0x02>;
			accdet-mic-vol = <0x05>;
			et7480-i2c-handle = <0x17>;
		};
	};

	fragment@26 {
		target = <0xffffffff>;

		__overlay__ {

			rcv_gpio_hight {
				phandle = <0x18>;

				pins_cmd_dat {
					bias-disable;
					drive-strength = <0x02>;
					output-high;
					pinmux = <0x3600>;
				};
			};

			rcv_gpio_low {
				phandle = <0x19>;

				pins_cmd_dat {
					bias-disable;
					drive-strength = <0x02>;
					output-low;
					pinmux = <0x3600>;
				};
			};
		};
	};

	fragment@27 {
		target = <0xffffffff>;

		__overlay__ {
			status = "okay";

			cs35l41@40 {
				#sound-dai-cells = <0x00>;
				cirrus,asp-sdout-hiz = <0x01>;
				cirrus,boost-cap-microfarad = <0x0f>;
				cirrus,boost-ind-nanohenry = <0x3e8>;
				cirrus,boost-peak-milliamp = <0x1194>;
				compatible = "cirrus,cs35l41";
				interrupt-parent = <0xffffffff>;
				interrupts = <0x1f 0x08 0x1f 0x00>;
				irq-gpio = <0xffffffff 0x1f 0x00>;
				phandle = <0x8e>;
				reg = <0x40>;
				reset-gpio = <0xffffffff 0x1e 0x00>;

				cirrus,gpio-config2 {
					cirrus,gpio-output-enable;
					cirrus,gpio-src-select = <0x04>;
				};
			};

			cs35l41@42 {
				#sound-dai-cells = <0x00>;
				cirrus,asp-sdout-hiz = <0x01>;
				cirrus,boost-cap-microfarad = <0x0f>;
				cirrus,boost-ind-nanohenry = <0x3e8>;
				cirrus,boost-peak-milliamp = <0x1194>;
				cirrus,tuning-has-prefix;
				compatible = "cirrus,cs35l41";
				interrupt-parent = <0xffffffff>;
				interrupts = <0x71 0x08 0x71 0x00>;
				irq-gpio = <0xffffffff 0x71 0x00>;
				phandle = <0x8f>;
				pinctrl-0 = <0x18>;
				pinctrl-1 = <0x19>;
				pinctrl-names = "rcv_gpio_hight\0rcv_gpio_low";
				reg = <0x42>;
				reset-gpio = <0xffffffff 0x1e 0x00>;

				cirrus,gpio-config2 {
					cirrus,gpio-output-enable;
					cirrus,gpio-src-select = <0x04>;
				};
			};
		};
	};

	fragment@28 {
		target = <0xffffffff>;

		__overlay__ {
			clock-frequency = <0x61a80>;
			pinctrl-0 = <0x1a>;
			pinctrl-1 = <0x1b>;
			pinctrl-2 = <0x1c>;
			pinctrl-3 = <0x1d>;
			pinctrl-4 = <0x1e>;
			pinctrl-5 = <0x1f>;
			pinctrl-names = "default\0ts_int_active\0ts_reset_active\0ts_int_suspend\0ts_reset_suspend\0ts_i2c_mode";

			gt9886@5d {
				compatible = "goodix,gt9886";
				goodix,config-version = "6893v01";
				goodix,firmware-version = "6893v01";
				goodix,input-max-x = <0x438>;
				goodix,input-max-y = <0x8e8>;
				goodix,irq-flags = <0x02>;
				goodix,irq-gpio = <0xffffffff 0x15 0x00>;
				goodix,key-of-pen = <0x14b 0x14c>;
				goodix,panel-key-map = <0x9e 0xac 0xd9>;
				goodix,panel-max-id = <0x0a>;
				goodix,panel-max-p = <0x100>;
				goodix,panel-max-w = <0x100>;
				goodix,panel-max-x = <0x438>;
				goodix,panel-max-y = <0x8e8>;
				goodix,pen-enable;
				goodix,power-off-delay-us = <0x1388>;
				goodix,power-on-delay-us = <0x2710>;
				goodix,reset-gpio = <0xffffffff 0x14 0x00>;
				interrupt-parent = <0xffffffff>;
				interrupts = <0x15 0x02 0x15 0x00>;
				reg = <0x5d>;
				status = "ok";
				tpd-filter-custom-prameters = <0x00 0x00 0x00 0x00 0x00 0x00 0x00 0x00 0x00 0x00 0x00 0x00>;
				tpd-filter-custom-speed = <0x00 0x00 0x00>;
				tpd-filter-enable = <0x00>;
				tpd-filter-pixel-density = <0xa1>;
				vtouch-supply = <0xffffffff>;
			};
		};
	};

	fragment@29 {
		target = <0xffffffff>;

		__overlay__ {
			#address-cells = <0x01>;
			#size-cells = <0x00>;
			pinctrl-0 = <0x20>;
			pinctrl-1 = <0x21>;
			pinctrl-2 = <0x22>;
			pinctrl-3 = <0x23>;
			pinctrl-4 = <0x24>;
			pinctrl-5 = <0x25>;
			pinctrl-names = "default\0gt9896s_int_active\0gt9896s_reset_active\0gt9896s_int_suspend\0gt9896s_reset_suspend\0gt9896s_spi_mode";
			status = "okay";

			gt9896s@0 {
				compatible = "goodix,gt9896s";
				goodix,avdd-name = "vtouch";
				goodix,config-version = "6893v02";
				goodix,firmware-version = "6893v02";
				goodix,input-max-x = <0x438>;
				goodix,input-max-y = <0x8fc>;
				goodix,irq-flags = <0x02>;
				goodix,irq-gpio = <0xffffffff 0x15 0x00>;
				goodix,panel-key-map = <0x9e 0xac 0xd9>;
				goodix,panel-max-id = <0x0a>;
				goodix,panel-max-p = <0x100>;
				goodix,panel-max-w = <0x100>;
				goodix,panel-max-x = <0x438>;
				goodix,panel-max-y = <0x8fc>;
				goodix,pen-enable;
				goodix,power-off-delay-us = <0x1388>;
				goodix,power-on-delay-us = <0x2710>;
				goodix,reset-gpio = <0xffffffff 0x14 0x00>;
				reg = <0x00>;
				spi-max-frequency = <0xf4240>;
				tpd-filter-custom-prameters = <0x00 0x00 0x00 0x00 0x00 0x00 0x00 0x00 0x00 0x00 0x00 0x00>;
				tpd-filter-custom-speed = <0x00 0x00 0x00>;
				tpd-filter-enable = <0x00>;
				tpd-filter-pixel-density = <0xa1>;
				vtouch-supply = <0xffffffff>;
			};
		};
	};

	fragment@3 {
		target = <0xffffffff>;

		__overlay__ {
			atag,videolfb-fb_base_h = <0x00>;
			atag,videolfb-fb_base_l = <0x7e020000>;
			atag,videolfb-fps = <0x1770>;
			atag,videolfb-islcm_inited = <0x00>;
			atag,videolfb-islcmfound = <0x01>;
			atag,videolfb-lcmname = "nt35595_fhd_dsi_cmd_truly_nt50358_drv";
			atag,videolfb-vramSize = <0x1be0000>;
		};
	};

	fragment@30 {
		target = <0xffffffff>;

		__overlay__ {

			eintdefault {
				phandle = <0x1a>;
			};

			i2cmode_default {
				phandle = <0x1f>;

				pins_cmd_dat {
					pinmux = <0xcc01 0xcd01>;
				};
			};

			int1_active {
				phandle = <0x21>;

				pins_cmd_dat {
					input-enable;
					pinmux = <0x1500>;
				};
			};

			int1_suspend {
				phandle = <0x23>;

				pins_cmd_dat {
					output-low;
					pinmux = <0x1500>;
				};
			};

			int_active {
				phandle = <0x1b>;

				pins_cmd_dat {
					input-enable;
					pinmux = <0x1500>;
				};
			};

			int_high {
				phandle = <0x90>;

				pins_cmd_dat {
					output-high;
					pinmux = <0x1500>;
				};
			};

			int_suspend {
				phandle = <0x1d>;

				pins_cmd_dat {
					output-low;
					pinmux = <0x1500>;
				};
			};

			pins_default {
				phandle = <0x20>;
			};

			reset1_active {
				phandle = <0x22>;

				pins_cmd_dat {
					output-high;
					pinmux = <0x1400>;
				};
			};

			reset1_suspend {
				phandle = <0x24>;

				pins_cmd_dat {
					output-low;
					pinmux = <0x1400>;
				};
			};

			reset_active {
				phandle = <0x1c>;

				pins_cmd_dat {
					output-high;
					pinmux = <0x1400>;
				};
			};

			reset_suspend {
				phandle = <0x1e>;

				pins_cmd_dat {
					output-low;
					pinmux = <0x1400>;
				};
			};

			spimode_default {
				phandle = <0x25>;

				pins_cmd_dat {
					drive-strength = <0x02>;
					pinmux = <0x1202 0x1302 0xcc02 0xcd02>;
				};
			};
		};
	};

	fragment@31 {
		target = <0xffffffff>;

		__overlay__ {
			debounce_time = <0x05>;
			hall_left = <0xffffffff 0x04 0x00>;
			hall_right = <0xffffffff 0x05 0x00>;
			key_left = <0xffffffff 0x6f 0x00>;
			key_right = <0xffffffff 0x70 0x00>;
			pinctrl-0 = <0x26 0x27>;
			pinctrl-1 = <0x28 0x29>;
			pinctrl-names = "gamekey_active\0gamekey_suspend";
			status = "ok";
		};
	};

	fragment@32 {
		target = <0xffffffff>;

		__overlay__ {

			gk_hall_act {
				phandle = <0x26>;

				pins_cmd0_dat {
					bias-disable;
					input-enable;
					pinmux = <0x400>;
				};

				pins_cmd1_dat {
					bias-disable;
					input-enable;
					pinmux = <0x500>;
				};
			};

			gk_hall_sup {
				phandle = <0x28>;
			};

			gk_key_act {
				phandle = <0x27>;

				pins_cmd0_dat {
					bias-pull-up;
					drive-strength = <0x02>;
					input-enable;
					pinmux = <0x6f00>;
				};

				pins_cmd1_dat {
					bias-pull-up;
					drive-strength = <0x02>;
					input-enable;
					pinmux = <0x7000>;
				};
			};

			gk_key_sup {
				phandle = <0x29>;

				pins_cmd0_dat {
					bias-disable;
					pinmux = <0x6f00>;
				};

				pins_cmd1_dat {
					bias-disable;
					pinmux = <0x7000>;
				};
			};
		};
	};

	fragment@33 {
		target = <0xffffffff>;

		__overlay__ {

			st21nfc@08 {
				compatible = "mediatek,nfc";
				gpio-irq = <0x0b>;
				gpio-irq-std = <0xffffffff 0x0b 0x00>;
				gpio-rst = <0x0a>;
				gpio-rst-std = <0xffffffff 0x0a 0x00>;
				interrupt-names = "nfc_irq";
				interrupt-parent = <0xffffffff>;
				interrupts = <0x0b 0x04 0x0b 0x00>;
				pinctrl-0 = <0xffffffff>;
				pinctrl-1 = <0xffffffff 0xffffffff>;
				pinctrl-2 = <0xffffffff 0xffffffff>;
				pinctrl-names = "default\0nfc_active\0nfc_suspend";
				reg = <0x08>;
			};
		};
	};

	fragment@34 {
		target = <0xffffffff>;

		__overlay__ {

			adc_channel@ {
				compatible = "mediatek,adc_channel";
				mediatek,adc_fdd_rf_params_dynamic_custom_ch = <0x02>;
				mediatek,temperature0 = <0x00>;
				mediatek,temperature1 = <0x01>;
				status = "okay";
			};
		};
	};

	fragment@35 {
		target = <0xffffffff>;

		__overlay__ {
			io-channels = <0xffffffff 0x02>;
		};
	};

	fragment@36 {
		target = <0xffffffff>;

		__overlay__ {
			mediatek,clkbuf-config = <0x02 0x01 0x01 0x02 0x00 0x00 0x01>;
			mediatek,clkbuf-controls-for-desense = <0x00 0x04 0x00 0x04 0x00 0x00 0x00>;
			mediatek,clkbuf-output-impedance = <0x03 0x04 0x03 0x04 0x00 0x00 0x03>;
			mediatek,clkbuf-quantity = <0x07>;
			status = "okay";
		};
	};

	fragment@37 {
		target = <0xffffffff>;

		__overlay__ {
			#address-cells = <0x01>;
			#size-cells = <0x00>;
			clock-frequency = <0x61a80>;
			mediatek,use-open-drain;
		};
	};

	fragment@38 {
		target = <0xffffffff>;

		__overlay__ {
			#address-cells = <0x01>;
			#size-cells = <0x00>;
			clock-frequency = <0x61a80>;
			mediatek,use-open-drain;
		};
	};

	fragment@39 {
		target = <0xffffffff>;

		__overlay__ {
			#address-cells = <0x01>;
			#size-cells = <0x00>;
			clock-frequency = <0x61a80>;
			mediatek,use-open-drain;

			camera_main@10 {
				compatible = "mediatek,camera_main";
				phandle = <0x91>;
				reg = <0x10>;
				status = "okay";
			};

			camera_main_af@0c {
				compatible = "mediatek,camera_main_af";
				phandle = <0x92>;
				reg = <0x0c>;
				status = "okay";
			};
		};
	};

	fragment@4 {
		target = <0xffffffff>;

		__overlay__ {
			bus-width = <0x08>;
			cap-mmc-highspeed;
			max-frequency = <0x4c4b40>;
			no-sd;
			no-sdio;
			non-removable;
			status = "okay";
			vmmc-supply = <0xffffffff>;
			vqmmc-supply = <0xffffffff>;
		};
	};

	fragment@40 {
		target = <0xffffffff>;

		__overlay__ {
			#address-cells = <0x01>;
			#size-cells = <0x00>;
			clock-frequency = <0x61a80>;
			mediatek,use-open-drain;
		};
	};

	fragment@41 {
		target = <0xffffffff>;

		__overlay__ {
			#address-cells = <0x01>;
			#size-cells = <0x00>;
			clock-frequency = <0x61a80>;
			mediatek,use-open-drain;

			camera_sub@10 {
				compatible = "mediatek,camera_sub";
				phandle = <0x93>;
				reg = <0x10>;
				status = "okay";
			};
		};
	};

	fragment@42 {
		target = <0xffffffff>;

		__overlay__ {
			#address-cells = <0x01>;
			#size-cells = <0x00>;
			clock-frequency = <0x33e140>;
			mediatek,use-push-pull;

			subpmic@34 {
				compatible = "mediatek,subpmic";
				phandle = <0x94>;
				reg = <0x34>;
				status = "okay";
			};

			subpmic_ldo@64 {
				compatible = "mediatek,subpmic_ldo";
				phandle = <0x97>;
				reg = <0x64>;
				status = "okay";
			};

			subpmic_pmic@1a {
				compatible = "mediatek,subpmic_pmic";
				phandle = <0x96>;
				reg = <0x1a>;
				status = "okay";
			};

			usb_type_c@4e {
				compatible = "mediatek,usb_type_c";
				phandle = <0x95>;
				reg = <0x4e>;
				status = "okay";
			};
		};
	};

	fragment@43 {
		target = <0xffffffff>;

		__overlay__ {
			#address-cells = <0x01>;
			#size-cells = <0x00>;
			clock-frequency = <0x61a80>;
			mediatek,use-open-drain;

			dp_switch@50 {
				compatible = "mediatek,dp_switch";
				phandle = <0x9a>;
				reg = <0x50>;
				status = "okay";
			};

			ext_buck_vmddr@61 {
				compatible = "mediatek,ext_buck_vmddr";
				phandle = <0x9b>;
				reg = <0x61>;
				status = "okay";
			};

			i2c_lcd_bias@3e {
				compatible = "mediatek,i2c_lcd_bias";
				phandle = <0x99>;
				reg = <0x3e>;
				status = "okay";
			};

			nfc@08 {
				compatible = "mediatek,nfc";
				phandle = <0x98>;
				reg = <0x08>;
				status = "okay";
			};
		};
	};

	fragment@44 {
		target = <0xffffffff>;

		__overlay__ {
			#address-cells = <0x01>;
			#size-cells = <0x00>;
			clock-frequency = <0x61a80>;
			mediatek,use-open-drain;
		};
	};

	fragment@45 {
		target = <0xffffffff>;

		__overlay__ {
			#address-cells = <0x01>;
			#size-cells = <0x00>;
			clock-frequency = <0x61a80>;
			mediatek,use-open-drain;

			camera_main_two@2d {
				compatible = "mediatek,camera_main_two";
				phandle = <0x9c>;
				reg = <0x2d>;
				status = "okay";
			};

			camera_main_two_af@0c {
				compatible = "mediatek,camera_main_two_af";
				phandle = <0x9d>;
				reg = <0x0c>;
				status = "okay";
			};

			camera_sub_two@1a {
				compatible = "mediatek,camera_sub_two";
				phandle = <0x9e>;
				reg = <0x1a>;
				status = "okay";
			};
		};
	};

	fragment@46 {
		target = <0xffffffff>;

		__overlay__ {
			#address-cells = <0x01>;
			#size-cells = <0x00>;
			clock-frequency = <0x61a80>;
			mediatek,use-open-drain;

			camera_main_three_af@0c {
				compatible = "mediatek,camera_main_three_af";
				phandle = <0x9f>;
				reg = <0x0c>;
				status = "okay";
			};
		};
	};

	fragment@47 {
		target = <0xffffffff>;

		__overlay__ {
			GPIO_SIM1_HOT_PLUG = <0xffffffff 0x2b 0x00>;
			GPIO_SIM1_SCLK = <0xffffffff 0x32 0x00>;
			GPIO_SIM1_SIO = <0xffffffff 0x30 0x00>;
			GPIO_SIM1_SRST = <0xffffffff 0x31 0x00>;
			GPIO_SIM2_SCLK = <0xffffffff 0x2d 0x00>;
			GPIO_SIM2_SIO = <0xffffffff 0x2f 0x00>;
			GPIO_SIM2_SRST = <0xffffffff 0x2e 0x00>;
		};
	};

	fragment@48 {
		target = <0xffffffff>;

		__overlay__ {
			gpio_init_default = <0x00 0x01 0x00 0x00 0x00 0x00 0x01 0x01 0x01 0x00 0x00 0x00 0x00 0x01 0x02 0x01 0x00 0x00 0x01 0x00 0x01 0x03 0x01 0x00 0x00 0x00 0x00 0x01 0x04 0x00 0x00 0x00 0x00 0x00 0x01 0x05 0x00 0x01 0x00 0x01 0x00 0x01 0x06 0x00 0x00 0x00 0x01 0x01 0x01 0x07 0x00 0x01 0x00 0x01 0x00 0x01 0x08 0x00 0x01 0x00 0x01 0x00 0x01 0x09 0x00 0x01 0x00 0x01 0x00 0x01 0x0a 0x00 0x01 0x00 0x01 0x00 0x00 0x0b 0x00 0x00 0x00 0x01 0x00 0x00 0x0c 0x00 0x00 0x00 0x01 0x01 0x00 0x0d 0x00 0x00 0x00 0x01 0x00 0x00 0x0e 0x00 0x01 0x00 0x01 0x00 0x00 0x0f 0x00 0x00 0x00 0x01 0x00 0x00 0x10 0x00 0x00 0x00 0x01 0x01 0x00 0x11 0x01 0x00 0x00 0x01 0x00 0x00 0x12 0x00 0x00 0x00 0x01 0x00 0x01 0x13 0x00 0x00 0x00 0x01 0x01 0x00 0x14 0x00 0x00 0x00 0x01 0x00 0x01 0x15 0x00 0x00 0x00 0x01 0x00 0x01 0x16 0x00 0x00 0x00 0x01 0x00 0x01 0x17 0x00 0x00 0x00 0x01 0x00 0x01 0x18 0x00 0x00 0x00 0x01 0x01 0x01 0x19 0x00 0x00 0x00 0x01 0x01 0x01 0x1a 0x00 0x01 0x00 0x01 0x00 0x01 0x1b 0x00 0x01 0x01 0x01 0x00 0x01 0x1c 0x00 0x01 0x00 0x01 0x00 0x00 0x1d 0x00 0x01 0x00 0x01 0x00 0x00 0x1e 0x00 0x01 0x00 0x01 0x00 0x01 0x1f 0x00 0x00 0x00 0x01 0x01 0x01 0x20 0x01 0x00 0x00 0x00 0x00 0x01 0x21 0x01 0x00 0x00 0x00 0x00 0x01 0x22 0x01 0x00 0x00 0x01 0x00 0x01 0x23 0x01 0x00 0x00 0x00 0x00 0x01 0x24 0x01 0x00 0x00 0x00 0x00 0x00 0x25 0x01 0x00 0x00 0x01 0x00 0x00 0x26 0x01 0x00 0x00 0x00 0x00 0x00 0x27 0x01 0x01 0x00 0x00 0x00 0x00 0x28 0x01 0x00 0x00 0x00 0x00 0x00 0x29 0x01 0x00 0x00 0x01 0x00 0x00 0x2a 0x00 0x01 0x00 0x00 0x00 0x00 0x2b 0x01 0x00 0x00 0x01 0x01 0x01 0x2c 0x00 0x00 0x00 0x01 0x00 0x00 0x2d 0x01 0x00 0x00 0x00 0x00 0x01 0x2e 0x01 0x00 0x00 0x00 0x00 0x01 0x2f 0x01 0x00 0x00 0x01 0x01 0x01 0x30 0x01 0x00 0x00 0x01 0x01 0x01 0x31 0x01 0x00 0x00 0x00 0x00 0x01 0x32 0x01 0x00 0x00 0x00 0x00 0x01 0x33 0x01 0x00 0x00 0x00 0x00 0x01 0x34 0x01 0x00 0x00 0x01 0x01 0x01 0x35 0x01 0x00 0x00 0x01 0x01 0x01 0x36 0x01 0x01 0x00 0x01 0x00 0x00 0x37 0x01 0x00 0x00 0x01 0x01 0x01 0x38 0x00 0x00 0x00 0x00 0x00 0x01 0x39 0x01 0x00 0x00 0x01 0x00 0x00 0x3a 0x01 0x00 0x00 0x01 0x00 0x00 0x3b 0x01 0x00 0x00 0x01 0x00 0x01 0x3c 0x01 0x00 0x00 0x01 0x00 0x01 0x3d 0x01 0x00 0x00 0x01 0x00 0x00 0x3e 0x01 0x00 0x00 0x01 0x00 0x01 0x3f 0x01 0x00 0x00 0x01 0x00 0x00 0x40 0x01 0x00 0x00 0x01 0x00 0x00 0x41 0x01 0x00 0x00 0x01 0x00 0x00 0x42 0x01 0x00 0x00 0x01 0x00 0x00 0x43 0x01 0x00 0x00 0x01 0x00 0x00 0x44 0x01 0x00 0x00 0x01 0x00 0x00 0x45 0x01 0x00 0x00 0x01 0x00 0x00 0x46 0x01 0x00 0x00 0x01 0x00 0x00 0x47 0x01 0x00 0x00 0x01 0x00 0x00 0x48 0x01 0x00 0x00 0x01 0x00 0x00 0x49 0x01 0x00 0x00 0x01 0x00 0x00 0x4a 0x01 0x00 0x00 0x01 0x00 0x00 0x4b 0x01 0x00 0x00 0x01 0x00 0x00 0x4c 0x01 0x00 0x00 0x01 0x00 0x00 0x4d 0x01 0x00 0x00 0x01 0x00 0x00 0x4e 0x01 0x00 0x00 0x01 0x00 0x00 0x4f 0x01 0x00 0x00 0x01 0x00 0x00 0x50 0x01 0x00 0x00 0x01 0x00 0x00 0x51 0x01 0x00 0x00 0x01 0x00 0x00 0x52 0x01 0x00 0x00 0x01 0x00 0x00 0x53 0x01 0x00 0x00 0x01 0x00 0x00 0x54 0x01 0x00 0x00 0x01 0x00 0x00 0x55 0x01 0x00 0x00 0x01 0x00 0x00 0x56 0x01 0x00 0x00 0x01 0x00 0x00 0x57 0x01 0x00 0x00 0x01 0x00 0x00 0x58 0x01 0x00 0x00 0x01 0x00 0x00 0x59 0x01 0x00 0x00 0x00 0x00 0x01 0x5a 0x01 0x00 0x00 0x00 0x00 0x01 0x5c 0x01 0x00 0x00 0x01 0x01 0x00 0x5d 0x01 0x00 0x00 0x00 0x00 0x00 0x5e 0x01 0x00 0x00 0x01 0x01 0x00 0x5f 0x01 0x00 0x00 0x00 0x00 0x00 0x60 0x07 0x00 0x00 0x01 0x00 0x00 0x61 0x07 0x00 0x00 0x01 0x00 0x00 0x62 0x07 0x00 0x00 0x01 0x00 0x00 0x63 0x07 0x00 0x00 0x00 0x00 0x00 0x64 0x07 0x00 0x00 0x01 0x00 0x00 0x65 0x07 0x00 0x00 0x01 0x00 0x00 0x66 0x00 0x01 0x00 0x00 0x00 0x00 0x67 0x07 0x00 0x00 0x00 0x00 0x00 0x68 0x07 0x00 0x00 0x01 0x00 0x00 0x69 0x07 0x00 0x00 0x01 0x00 0x00 0x6a 0x07 0x00 0x00 0x01 0x00 0x00 0x6b 0x07 0x00 0x00 0x01 0x00 0x01 0x6c 0x07 0x00 0x00 0x01 0x00 0x00 0x6d 0x00 0x01 0x00 0x00 0x00 0x00 0x6e 0x00 0x00 0x00 0x01 0x01 0x00 0x6f 0x00 0x01 0x00 0x01 0x00 0x00 0x70 0x00 0x01 0x00 0x01 0x00 0x00 0x71 0x00 0x01 0x00 0x01 0x00 0x00 0x72 0x02 0x00 0x00 0x01 0x00 0x00 0x73 0x02 0x00 0x00 0x00 0x00 0x00 0x74 0x02 0x00 0x00 0x00 0x00 0x00 0x75 0x02 0x00 0x00 0x00 0x00 0x00 0x76 0x02 0x00 0x00 0x01 0x01 0x01 0x77 0x02 0x00 0x00 0x01 0x01 0x01 0x78 0x01 0x00 0x00 0x01 0x01 0x01 0x79 0x01 0x00 0x00 0x01 0x01 0x01 0x7a 0x01 0x00 0x00 0x01 0x01 0x01 0x7b 0x01 0x00 0x00 0x01 0x01 0x01 0x7c 0x01 0x00 0x00 0x01 0x01 0x01 0x7d 0x01 0x00 0x00 0x01 0x01 0x01 0x7e 0x05 0x00 0x00 0x01 0x01 0x00 0x7f 0x05 0x00 0x00 0x01 0x01 0x00 0x80 0x00 0x01 0x00 0x01 0x00 0x00 0x81 0x00 0x01 0x00 0x01 0x00 0x00 0x82 0x01 0x00 0x00 0x01 0x00 0x00 0x83 0x01 0x00 0x00 0x01 0x00 0x00 0x84 0x01 0x00 0x00 0x01 0x01 0x00 0x85 0x00 0x01 0x00 0x01 0x00 0x00 0x86 0x00 0x01 0x00 0x01 0x00 0x00 0x87 0x00 0x01 0x00 0x01 0x00 0x00 0x88 0x00 0x01 0x00 0x01 0x00 0x00 0x89 0x00 0x01 0x00 0x01 0x00 0x00 0x8a 0x00 0x01 0x00 0x01 0x00 0x00 0x8b 0x01 0x00 0x00 0x01 0x01 0x01 0x8c 0x01 0x00 0x00 0x01 0x01 0x01 0x8d 0x01 0x00 0x00 0x01 0x01 0x01 0x8e 0x01 0x00 0x00 0x01 0x01 0x01 0x8f 0x00 0x01 0x00 0x01 0x00 0x00 0x90 0x00 0x01 0x00 0x01 0x00 0x00 0x91 0x00 0x01 0x00 0x01 0x00 0x00 0x92 0x00 0x01 0x00 0x01 0x00 0x00 0x93 0x00 0x01 0x00 0x01 0x00 0x00 0x94 0x00 0x01 0x00 0x01 0x00 0x00 0x95 0x00 0x01 0x00 0x01 0x00 0x00 0x96 0x01 0x00 0x00 0x00 0x00 0x00 0x97 0x00 0x01 0x00 0x01 0x00 0x00 0x98 0x00 0x00 0x00 0x01 0x00 0x00 0x99 0x01 0x00 0x00 0x00 0x00 0x00 0x9a 0x01 0x00 0x00 0x01 0x01 0x00 0x9b 0x01 0x00 0x00 0x01 0x01 0x00 0x9c 0x01 0x00 0x00 0x00 0x00 0x00 0x9d 0x00 0x00 0x00 0x00 0x00 0x00 0x9e 0x01 0x00 0x00 0x01 0x00 0x00 0x9f 0x01 0x00 0x00 0x00 0x00 0x00 0xa0 0x03 0x00 0x00 0x01 0x01 0x01 0xa1 0x03 0x00 0x00 0x01 0x01 0x01 0xa2 0x00 0x00 0x00 0x01 0x00 0x01 0xa3 0x00 0x00 0x00 0x01 0x00 0x01 0xa4 0x00 0x00 0x00 0x01 0x00 0x01 0xa5 0x01 0x00 0x00 0x01 0x00 0x01 0xa6 0x01 0x00 0x00 0x01 0x00 0x01 0xa7 0x00 0x00 0x00 0x01 0x00 0x01 0xa8 0x00 0x00 0x00 0x01 0x01 0x00 0xa9 0x00 0x00 0x00 0x01 0x01 0x00 0xaa 0x06 0x00 0x00 0x01 0x01 0x01 0xab 0x06 0x00 0x00 0x01 0x01 0x01 0xac 0x00 0x00 0x00 0x01 0x00 0x00 0xad 0x00 0x00 0x00 0x01 0x00 0x00 0xae 0x00 0x00 0x00 0x01 0x00 0x00 0xaf 0x00 0x00 0x00 0x01 0x00 0x00 0xb0 0x00 0x00 0x00 0x01 0x00 0x00 0xb1 0x00 0x00 0x00 0x01 0x00 0x00 0xb2 0x00 0x00 0x00 0x01 0x00 0x00 0xb3 0x00 0x00 0x00 0x01 0x00 0x00 0xb4 0x00 0x00 0x00 0x01 0x00 0x00 0xb5 0x00 0x00 0x00 0x01 0x00 0x00 0xb6 0x00 0x00 0x00 0x01 0x00 0x00 0xc3 0x01 0x00 0x00 0x00 0x00 0x00 0xc4 0x01 0x00 0x00 0x00 0x00 0x01 0xc5 0x01 0x00 0x00 0x00 0x00 0x01 0xc6 0x01 0x00 0x00 0x00 0x00 0x01 0xc7 0x01 0x00 0x00 0x01 0x00 0x01 0xc8 0x01 0x00 0x00 0x01 0x01 0x01 0xc9 0x01 0x00 0x00 0x01 0x01 0x01 0xca 0x01 0x00 0x00 0x01 0x01 0x01 0xcb 0x01 0x00 0x00 0x01 0x01 0x01 0xcc 0x01 0x00 0x00 0x01 0x01 0x01 0xcd 0x01 0x00 0x00 0x01 0x01 0x01 0xce 0x01 0x00 0x00 0x00 0x00 0x00 0xcf 0x01 0x00 0x00 0x00 0x00 0x00 0xd0 0x01 0x00 0x00 0x00 0x00 0x00 0xd1 0x01 0x00 0x00 0x01 0x00 0x00 0xd2 0x01 0x00 0x00 0x00 0x00 0x00 0xd3 0x01 0x00 0x00 0x00 0x00 0x00 0xd4 0x01 0x00 0x00 0x00 0x00 0x00 0xd5 0x01 0x00 0x00 0x01 0x00 0x00 0xd6 0x01 0x00 0x00 0x00 0x00 0x01 0xd7 0x01 0x00 0x00 0x00 0x00 0x01 0xd8 0x01 0x00 0x00 0x00 0x00 0x01 0xd9 0x01 0x00 0x00 0x00 0x00 0x01 0xda 0x01 0x00 0x00 0x01 0x00 0x01 0xdb 0x01 0x00 0x00 0x01 0x00 0x01 0xdc 0x00 0x00 0x00 0x01 0x00 0x00 0xdd 0x00 0x00 0x00 0x01 0x00 0x00 0xde 0x00 0x00 0x00 0x01 0x00 0x00 0xdf 0x00 0x00 0x00 0x01 0x00 0x00 0xe0 0x00 0x00 0x00 0x01 0x00 0x00 0xe1 0x00 0x00 0x00 0x01 0x00 0x00 0xe2 0x00 0x00 0x00 0x01 0x00 0x00>;
		};
	};

	fragment@49 {
		target = <0xffffffff>;

		__overlay__ {
			deb-gpios = <0xffffffff 0x06 0x00>;
			debounce = <0x7d000>;
			interrupt-parent = <0xffffffff>;
			interrupts = <0x06 0x08 0x06 0x00>;
			status = "okay";
		};
	};

	fragment@5 {
		target = <0xffffffff>;

		__overlay__ {

			led@0 {
				compatible = "mediatek,red";
				data = <0x01>;
				led_mode = <0x00>;
				phandle = <0x85>;
				pwm_config = <0x00 0x00 0x00 0x00 0x00>;
			};

			led@1 {
				compatible = "mediatek,green";
				data = <0x01>;
				led_mode = <0x00>;
				phandle = <0x86>;
				pwm_config = <0x00 0x00 0x00 0x00 0x00>;
			};

			led@2 {
				compatible = "mediatek,blue";
				data = <0x01>;
				led_mode = <0x00>;
				phandle = <0x87>;
				pwm_config = <0x00 0x00 0x00 0x00 0x00>;
			};

			led@3 {
				compatible = "mediatek,jogball-backlight";
				data = <0x01>;
				led_mode = <0x00>;
				phandle = <0x88>;
				pwm_config = <0x00 0x00 0x00 0x00 0x00>;
			};

			led@4 {
				compatible = "mediatek,keyboard-backlight";
				data = <0x01>;
				led_mode = <0x00>;
				phandle = <0x89>;
				pwm_config = <0x00 0x00 0x00 0x00 0x00>;
			};

			led@5 {
				compatible = "mediatek,button-backlight";
				data = <0x01>;
				led_mode = <0x00>;
				phandle = <0x8a>;
				pwm_config = <0x00 0x00 0x00 0x00 0x00>;
			};

			led@6 {
				compatible = "mediatek,lcd-backlight";
				data = <0x01>;
				led_mode = <0x04>;
				phandle = <0x8b>;
				pwm_config = <0x00 0x01 0x00 0x00 0x00>;
			};

			usb_c_pinctrl {
				compatible = "mediatek,usb_c_pinctrl";
				phandle = <0x8d>;
			};

			vibrator@0 {
				compatible = "mediatek,vibrator";
				phandle = <0x8c>;
				vib_limit = <0x09>;
				vib_timer = <0x19>;
				vib_vol = <0x0b>;
			};
		};
	};

	fragment@50 {
		target = <0xffffffff>;

		__overlay__ {
			interrupt-parent = <0xffffffff>;
			interrupts = <0x0b 0x04 0x0b 0x00>;
			status = "okay";
		};
	};

	fragment@51 {
		target = <0xffffffff>;

		__overlay__ {
			interrupt-parent = <0xffffffff>;
			interrupts = <0x15 0x01 0x15 0x00>;
			status = "okay";
		};
	};

	fragment@52 {
		target = <0xffffffff>;

		__overlay__ {
			interrupt-parent = <0xffffffff>;
			interrupts = <0x18 0x02 0x18 0x00>;
			status = "okay";
		};
	};

	fragment@53 {
		target = <0xffffffff>;

		__overlay__ {
			interrupt-parent = <0xffffffff>;
			interrupts = <0x19 0x02 0x19 0x00>;
			status = "okay";
		};
	};

	fragment@54 {
		target = <0xffffffff>;

		__overlay__ {
			interrupt-parent = <0xffffffff>;
			interrupts = <0x1f 0x08 0x1f 0x00>;
			status = "okay";
		};
	};

	fragment@55 {
		target = <0xffffffff>;

		__overlay__ {
			interrupt-parent = <0xffffffff>;
			interrupts = <0x29 0x01 0x29 0x01>;
			status = "okay";
		};
	};

	fragment@56 {
		target = <0xffffffff>;

		__overlay__ {
			compatible = "mediatek,md1_sim1_hot_plug_eint-eint";
			debounce = <0x00 0xc350>;
			dedicated = <0x00 0x00>;
			interrupts = <0x00 0x08>;
			sockettype = <0x00 0x00>;
			src_pin = <0x00 0x01>;
			status = "okay";
		};
	};

	fragment@57 {
		target = <0xffffffff>;

		__overlay__ {
			regulator-default-on = <0x01>;
			regulator-name = "vcamio";
			status = "okay";
		};
	};

	fragment@58 {
		target = <0xffffffff>;

		__overlay__ {
			regulator-default-on = <0x01>;
			regulator-name = "vtp";
			status = "okay";
		};
	};

	fragment@59 {
		target = <0xffffffff>;

		__overlay__ {
			status = "okay";
			vcamaf-supply = <0xffffffff>;
			vcamaf_main2-supply = <0xffffffff>;
			vcamio-supply = <0xffffffff>;
			vcamio_main2-supply = <0xffffffff>;
			vcamio_sub-supply = <0xffffffff>;
		};
	};

	fragment@6 {
		target = <0xffffffff>;

		__overlay__ {

			lcm_dsi_te {
				phandle = <0x03>;

				pins_cmd_dat {
					pinmux = <0x2901>;
				};
			};

			lcm_rst_out0_gpio {
				phandle = <0x02>;

				pins_cmd_dat {
					output-low;
					pinmux = <0x2a00>;
					slew-rate = <0x01>;
				};
			};

			lcm_rst_out1_gpio {
				phandle = <0x01>;

				pins_cmd_dat {
					output-high;
					pinmux = <0x2a00>;
					slew-rate = <0x01>;
				};
			};
		};
	};

	fragment@60 {
		target = <0xffffffff>;

		__overlay__ {
			status = "okay";
			vtouch-supply = <0xffffffff>;
		};
	};

	fragment@61 {
		target = <0xffffffff>;

		__overlay__ {
			mediatek,kpd-hw-factory-key = <0x01>;
			mediatek,kpd-hw-init-map = <0x73 0x72 0x00 0x00 0x00 0x00 0x00 0x00 0x00 0x00 0x00 0x00 0x00 0x00 0x00 0x00 0x00 0x00 0x00 0x00 0x00 0x00 0x00 0x00 0x00 0x00 0x00 0x00 0x00 0x00 0x00 0x00 0x00 0x00 0x00 0x00 0x00 0x00 0x00 0x00 0x00 0x00 0x00 0x00 0x00 0x00 0x00 0x00 0x00 0x00 0x00 0x00 0x00 0x00 0x00 0x00 0x00 0x00 0x00 0x00 0x00 0x00 0x00 0x00 0x00 0x00 0x00 0x00 0x00 0x00 0x00 0x00>;
			mediatek,kpd-hw-map-num = <0x48>;
			mediatek,kpd-hw-pwrkey = <0x08>;
			mediatek,kpd-hw-recovery-key = <0x00>;
			mediatek,kpd-key-debounce = <0x400>;
			mediatek,kpd-pwkey-gpio-din = <0x00>;
			mediatek,kpd-pwrkey-eint-gpio = <0x00>;
			mediatek,kpd-sw-pwrkey = <0x74>;
			mediatek,kpd-use-extend-type = <0x00>;
			status = "okay";
		};
	};

	fragment@62 {
		target = <0xffffffff>;

		__overlay__ {

			ts_dvdddisable {
				phandle = <0x30>;

				pins_cmd_dat {
					output-low;
					pinmux = <0x1b00>;
				};
			};

			ts_dvddenable {
				phandle = <0x2f>;

				pins_cmd_dat {
					output-high;
					pinmux = <0x1b00>;
				};
			};

			ts_int_active {
				phandle = <0x2b>;

				pins_cmd_dat {
					input-enable;
					pinmux = <0x1500>;
				};
			};

			ts_int_suspend {
				phandle = <0x2c>;

				pins_cmd_dat {
					bias-pull-down;
					pinmux = <0x1500>;
					slew-rate = <0x01>;
				};
			};

			ts_release {
				phandle = <0xa0>;

				pins_cmd0_dat {
					bias-pull-up;
					pinmux = <0x1400>;
					slew-rate = <0x01>;
				};

				pins_cmd1_dat {
					bias-disable;
					pinmux = <0x1500>;
					slew-rate = <0x01>;
				};
			};

			ts_reset_active {
				phandle = <0x2a>;

				pins_cmd_dat {
					output-high;
					pinmux = <0x1400>;
				};
			};

			ts_reset_suspend {
				phandle = <0x2d>;

				pins_cmd_dat {
					bias-pull-down;
					pinmux = <0x1400>;
					slew-rate = <0x01>;
				};
			};

			ts_spimode {
				phandle = <0x2e>;

				pins_cmd_dat {
					drive-strength = <0x07>;
					pinmux = <0x01 0x101 0x201 0x301>;
				};
			};
		};
	};

	fragment@63 {
		target = <0xffffffff>;

		__overlay__ {
			regulator-boot-on;
			regulator-max-microvolt = <0x325aa0>;
			regulator-min-microvolt = <0x325aa0>;
		};
	};

	fragment@64 {
		target = <0xffffffff>;

		__overlay__ {
			#address-cells = <0x01>;
			#size-cells = <0x00>;
			status = "okay";

			fts@0 {
				avdd-supply = <0xffffffff>;
				compatible = "st,spi";
				fts,config-array-size = <0x01>;
				fts,cornerfilter-area-step1 = <0x64>;
				fts,cornerfilter-area-step2 = <0xaa>;
				fts,cornerfilter-area-step3 = <0xfa>;
				fts,default-fw-name = "st_fts_k11st.ftb";
				fts,htp-fw-name = "st_fts_k11st_htp.ftb";
				fts,irq-flags = <0x2008>;
				fts,irq-gpio = <0xffffffff 0x15 0x2008>;
				fts,irq-gpio-name = "fts_irq";
				fts,non-curved-display = <0x01>;
				fts,pwr-reg-name = "avdd";
				fts,reset-gpio = <0xffffffff 0x14 0x00>;
				fts,reset-gpio-enable;
				fts,reset-gpio-name = "fts_rst";
				fts,spi-speed = "7000000";
				fts,touch-aim-sensitivity = <0x0a 0x08 0x06 0x04 0x02>;
				fts,touch-aim-sensitivity-def = <0x03>;
				fts,touch-cornerzone-filter-hor1 = <0x00 0x00 0x00 0x00 0x96 0x96 0x00 0x00 0x00 0x01 0x00 0x00 0x00 0x00 0x00 0x00 0x00 0x02 0x00 0x8c9 0x96 0x95f 0x00 0x00 0x00 0x03 0x00 0x00 0x00 0x00 0x00 0x00>;
				fts,touch-cornerzone-filter-hor2 = <0x00 0x00 0x00 0x00 0x00 0x00 0x00 0x00 0x00 0x01 0x3a1 0x00 0x437 0x96 0x00 0x00 0x00 0x02 0x00 0x00 0x00 0x00 0x00 0x00 0x00 0x03 0x3a1 0x8c9 0x437 0x95f 0x00 0x00>;
				fts,touch-cornerzone-filter-ver = <0x00 0x00 0x00 0x00 0x00 0x00 0x00 0x00 0x00 0x01 0x00 0x00 0x00 0x00 0x00 0x00 0x00 0x02 0x00 0x833 0x96 0x95f 0x00 0x00 0x00 0x03 0x3a1 0x833 0x437 0x95f 0x00 0x00>;
				fts,touch-edgezone-filter-hor = <0x01 0x00 0x00 0x00 0x437 0x28 0x00 0x00 0x01 0x01 0x00 0x937 0x437 0x95f 0x00 0x00 0x01 0x02 0x00 0x00 0x28 0x95f 0x00 0x00 0x01 0x03 0x40f 0x00 0x437 0x95f 0x00 0x00>;
				fts,touch-edgezone-filter-ver = <0x01 0x00 0x00 0x00 0x00 0x00 0x00 0x00 0x01 0x01 0x00 0x00 0x00 0x00 0x00 0x00 0x01 0x02 0x00 0x00 0x28 0x95f 0x00 0x00 0x01 0x03 0x40f 0x00 0x437 0x95f 0x00 0x00>;
				fts,touch-expert-array = <0x06 0x0f 0x01 0x78 0x06 0x0f 0x02 0x0f 0x01 0x78 0x04 0x0f 0x04 0x0f 0x01 0x78 0x02 0x0f>;
				fts,touch-follow-performance = <0x0a 0x0f 0x01 0x08 0x0f 0x01 0x06 0x0f 0x01 0x04 0x0f 0x01 0x02 0x0f 0x01>;
				fts,touch-follow-performance-def = <0x03>;
				fts,touch-normal-cornerzone-filter-hor1 = <0x00 0x00 0x00 0x00 0xaa 0xaa 0x00 0x00 0x00 0x01 0x00 0x00 0x00 0x00 0x00 0x00 0x00 0x02 0x00 0x8b5 0xaa 0x95f 0x00 0x00 0x00 0x03 0x00 0x00 0x00 0x00 0x00 0x00>;
				fts,touch-normal-cornerzone-filter-hor2 = <0x00 0x00 0x00 0x00 0x00 0x00 0x00 0x00 0x00 0x01 0x38d 0x00 0x437 0xaa 0x00 0x00 0x00 0x02 0x00 0x00 0x00 0x00 0x00 0x00 0x00 0x03 0x38d 0x8b5 0x437 0x95f 0x00 0x00>;
				fts,touch-normal-edgezone-filter-hor = <0x01 0x00 0x00 0x00 0x437 0x1e 0x00 0x00 0x01 0x01 0x00 0x941 0x437 0x95f 0x00 0x00 0x01 0x02 0x00 0x00 0x1e 0x95f 0x00 0x00 0x01 0x03 0x419 0x00 0x437 0x95f 0x00 0x00>;
				fts,touch-tap-sensitivity = <0xa0 0x96 0x8c 0x78 0x64>;
				fts,touch-tap-sensitivity-def = <0x04>;
				fts,touch-tap-stability = <0x08 0x0c 0x0f 0x12 0x19>;
				fts,touch-tap-stability-def = <0x03>;
				fts,x-max = <0x2a30>;
				fts,y-max = <0x5dc0>;
				interrupt-parent = <0xffffffff>;
				interrupts = <0x15 0x02 0x15 0x00>;
				pinctrl-0 = <0x2a 0x2b>;
				pinctrl-1 = <0x2c 0x2d>;
				pinctrl-2 = <0x2e>;
				pinctrl-3 = <0x2f>;
				pinctrl-4 = <0x30>;
				pinctrl-names = "pmx_ts_active\0pmx_ts_suspend\0pmx_ts_spi_mode\0pmx_ts_dvdd_enable\0pmx_ts_dvdd_disable";
				reg = <0x00>;
				spi-max-frequency = <0x5b8d80>;
				status = "ok";

				fts,cfg_0 {
					fts,fw-name = "st_fts_k11st.ftb";
					fts,limit-name = "stm_fts_production_limits_k11st.csv";
					fts,tp-vendor = <0x42>;
				};
			};
		};
	};

	fragment@65 {
		target = <0xffffffff>;

		__overlay__ {
			regulator-default-on = <0x01>;
			status = "okay";
		};
	};

	fragment@66 {
		target = <0xffffffff>;

		__overlay__ {

			cam0@0 {
				phandle = <0x36>;

				pins_cmd_dat {
					output-low;
					pinmux = <0x9100>;
					slew-rate = <0x01>;
				};
			};

			cam0@1 {
				phandle = <0x37>;

				pins_cmd_dat {
					output-high;
					pinmux = <0x9100>;
					slew-rate = <0x01>;
				};
			};

			cam0@2 {
				phandle = <0x38>;

				pins_cmd_dat {
					output-low;
					pinmux = <0x9200>;
					slew-rate = <0x01>;
				};
			};

			cam0@3 {
				phandle = <0x39>;

				pins_cmd_dat {
					output-high;
					pinmux = <0x9200>;
					slew-rate = <0x01>;
				};
			};

			cam0@vcam0 {
				phandle = <0x4a>;

				pins_cmd_dat {
					output-low;
					pinmux = <0x400>;
					slew-rate = <0x01>;
				};
			};

			cam0@vcam1 {
				phandle = <0x4b>;

				pins_cmd_dat {
					output-high;
					pinmux = <0x400>;
					slew-rate = <0x01>;
				};
			};

			cam0@vcam2 {
				phandle = <0x4c>;

				pins_cmd_dat {
					output-low;
					pinmux = <0x7000>;
					slew-rate = <0x01>;
				};
			};

			cam0@vcam3 {
				phandle = <0x4d>;

				pins_cmd_dat {
					output-high;
					pinmux = <0x7000>;
					slew-rate = <0x01>;
				};
			};

			cam1@0 {
				phandle = <0x3a>;

				pins_cmd_dat {
					output-low;
					pinmux = <0x8300>;
					slew-rate = <0x01>;
				};
			};

			cam1@1 {
				phandle = <0x3b>;

				pins_cmd_dat {
					output-high;
					pinmux = <0x8300>;
					slew-rate = <0x01>;
				};
			};

			cam1@2 {
				phandle = <0x3c>;

				pins_cmd_dat {
					output-low;
					pinmux = <0x9200>;
					slew-rate = <0x01>;
				};
			};

			cam1@3 {
				phandle = <0x3d>;

				pins_cmd_dat {
					output-high;
					pinmux = <0x9200>;
					slew-rate = <0x01>;
				};
			};

			cam1@vcam0 {
				phandle = <0x4e>;

				pins_cmd_dat {
					output-low;
					pinmux = <0x6d00>;
					slew-rate = <0x01>;
				};
			};

			cam1@vcam1 {
				phandle = <0x4f>;

				pins_cmd_dat {
					output-high;
					pinmux = <0x6d00>;
					slew-rate = <0x01>;
				};
			};

			cam1@vcam2 {
				phandle = <0x50>;

				pins_cmd_dat {
					output-low;
					pinmux = <0x6f00>;
					slew-rate = <0x01>;
				};
			};

			cam1@vcam3 {
				phandle = <0x51>;

				pins_cmd_dat {
					output-high;
					pinmux = <0x6f00>;
					slew-rate = <0x01>;
				};
			};

			cam2@0 {
				phandle = <0x3e>;

				pins_cmd_dat {
					output-low;
					pinmux = <0x8200>;
					slew-rate = <0x01>;
				};
			};

			cam2@1 {
				phandle = <0x3f>;

				pins_cmd_dat {
					output-high;
					pinmux = <0x8200>;
					slew-rate = <0x01>;
				};
			};

			cam2@2 {
				phandle = <0x40>;

				pins_cmd_dat {
					output-low;
					pinmux = <0x9200>;
					slew-rate = <0x01>;
				};
			};

			cam2@3 {
				phandle = <0x41>;

				pins_cmd_dat {
					output-high;
					pinmux = <0x9200>;
					slew-rate = <0x01>;
				};
			};

			cam2@vcam0 {
				phandle = <0x52>;

				pins_cmd_dat {
					output-low;
					pinmux = <0x9200>;
					slew-rate = <0x01>;
				};
			};

			cam2@vcam1 {
				phandle = <0x53>;

				pins_cmd_dat {
					output-high;
					pinmux = <0x9200>;
					slew-rate = <0x01>;
				};
			};

			cam2@vcam2 {
				phandle = <0x54>;

				pins_cmd_dat {
					output-low;
					pinmux = <0x9200>;
					slew-rate = <0x01>;
				};
			};

			cam2@vcam3 {
				phandle = <0x55>;

				pins_cmd_dat {
					output-high;
					pinmux = <0x9200>;
					slew-rate = <0x01>;
				};
			};

			cam3@0 {
				phandle = <0x42>;

				pins_cmd_dat {
					output-low;
					pinmux = <0x9000>;
					slew-rate = <0x01>;
				};
			};

			cam3@1 {
				phandle = <0x43>;

				pins_cmd_dat {
					output-high;
					pinmux = <0x9000>;
					slew-rate = <0x01>;
				};
			};

			cam3@2 {
				phandle = <0x44>;

				pins_cmd_dat {
					output-low;
					pinmux = <0x9200>;
					slew-rate = <0x01>;
				};
			};

			cam3@3 {
				phandle = <0x45>;

				pins_cmd_dat {
					output-high;
					pinmux = <0x9200>;
					slew-rate = <0x01>;
				};
			};

			cam3@vcam0 {
				phandle = <0x56>;

				pins_cmd_dat {
					output-low;
					pinmux = <0x9200>;
					slew-rate = <0x01>;
				};
			};

			cam3@vcam1 {
				phandle = <0x57>;

				pins_cmd_dat {
					output-high;
					pinmux = <0x9200>;
					slew-rate = <0x01>;
				};
			};

			cam3@vcam2 {
				phandle = <0x58>;

				pins_cmd_dat {
					output-low;
					pinmux = <0x9200>;
					slew-rate = <0x01>;
				};
			};

			cam3@vcam3 {
				phandle = <0x59>;

				pins_cmd_dat {
					output-high;
					pinmux = <0x9200>;
					slew-rate = <0x01>;
				};
			};

			cam4@0 {
				phandle = <0x46>;

				pins_cmd_dat {
					output-low;
					pinmux = <0x9200>;
					slew-rate = <0x01>;
				};
			};

			cam4@1 {
				phandle = <0x47>;

				pins_cmd_dat {
					output-high;
					pinmux = <0x9200>;
					slew-rate = <0x01>;
				};
			};

			cam4@2 {
				phandle = <0x48>;

				pins_cmd_dat {
					output-low;
					pinmux = <0x9200>;
					slew-rate = <0x01>;
				};
			};

			cam4@3 {
				phandle = <0x49>;

				pins_cmd_dat {
					output-high;
					pinmux = <0x9200>;
					slew-rate = <0x01>;
				};
			};

			cam4@vcam0 {
				phandle = <0x5a>;

				pins_cmd_dat {
					output-low;
					pinmux = <0x9200>;
					slew-rate = <0x01>;
				};
			};

			cam4@vcam1 {
				phandle = <0x5b>;

				pins_cmd_dat {
					output-high;
					pinmux = <0x9200>;
					slew-rate = <0x01>;
				};
			};

			cam4@vcam2 {
				phandle = <0x5c>;

				pins_cmd_dat {
					output-low;
					pinmux = <0x9200>;
					slew-rate = <0x01>;
				};
			};

			cam4@vcam3 {
				phandle = <0x5d>;

				pins_cmd_dat {
					output-high;
					pinmux = <0x9200>;
					slew-rate = <0x01>;
				};
			};

			camdefault {
				phandle = <0x35>;
			};

			camera_pins_cam0_mclk_2ma {
				phandle = <0x5f>;

				pins_cmd_dat {
					drive-strength = <0x00>;
					pinmux = <0x9501>;
				};
			};

			camera_pins_cam0_mclk_4ma {
				phandle = <0x60>;

				pins_cmd_dat {
					drive-strength = <0x01>;
					pinmux = <0x9501>;
				};
			};

			camera_pins_cam0_mclk_6ma {
				phandle = <0x61>;

				pins_cmd_dat {
					drive-strength = <0x02>;
					pinmux = <0x9501>;
				};
			};

			camera_pins_cam0_mclk_8ma {
				phandle = <0x62>;

				pins_cmd_dat {
					drive-strength = <0x03>;
					pinmux = <0x9501>;
				};
			};

			camera_pins_cam0_mclk_off {
				phandle = <0x5e>;

				pins_cmd_dat {
					drive-strength = <0x01>;
					pinmux = <0x9500>;
				};
			};

			camera_pins_cam1_mclk_2ma {
				phandle = <0x64>;

				pins_cmd_dat {
					drive-strength = <0x00>;
					pinmux = <0x8901>;
				};
			};

			camera_pins_cam1_mclk_4ma {
				phandle = <0x65>;

				pins_cmd_dat {
					drive-strength = <0x01>;
					pinmux = <0x8901>;
				};
			};

			camera_pins_cam1_mclk_6ma {
				phandle = <0x66>;

				pins_cmd_dat {
					drive-strength = <0x02>;
					pinmux = <0x8901>;
				};
			};

			camera_pins_cam1_mclk_8ma {
				phandle = <0x67>;

				pins_cmd_dat {
					drive-strength = <0x03>;
					pinmux = <0x8901>;
				};
			};

			camera_pins_cam1_mclk_off {
				phandle = <0x63>;

				pins_cmd_dat {
					drive-strength = <0x01>;
					pinmux = <0x8900>;
				};
			};

			camera_pins_cam2_mclk_2ma {
				phandle = <0x69>;

				pins_cmd_dat {
					drive-strength = <0x00>;
					pinmux = <0x8801>;
				};
			};

			camera_pins_cam2_mclk_4ma {
				phandle = <0x6a>;

				pins_cmd_dat {
					drive-strength = <0x01>;
					pinmux = <0x8801>;
				};
			};

			camera_pins_cam2_mclk_6ma {
				phandle = <0x6b>;

				pins_cmd_dat {
					drive-strength = <0x02>;
					pinmux = <0x8801>;
				};
			};

			camera_pins_cam2_mclk_8ma {
				phandle = <0x6c>;

				pins_cmd_dat {
					drive-strength = <0x03>;
					pinmux = <0x8801>;
				};
			};

			camera_pins_cam2_mclk_off {
				phandle = <0x68>;

				pins_cmd_dat {
					drive-strength = <0x01>;
					pinmux = <0x8800>;
				};
			};

			camera_pins_cam3_mclk_2ma {
				phandle = <0x6e>;

				pins_cmd_dat {
					drive-strength = <0x00>;
					pinmux = <0x9701>;
				};
			};

			camera_pins_cam3_mclk_4ma {
				phandle = <0x6f>;

				pins_cmd_dat {
					drive-strength = <0x01>;
					pinmux = <0x9701>;
				};
			};

			camera_pins_cam3_mclk_6ma {
				phandle = <0x70>;

				pins_cmd_dat {
					drive-strength = <0x02>;
					pinmux = <0x9701>;
				};
			};

			camera_pins_cam3_mclk_8ma {
				phandle = <0x71>;

				pins_cmd_dat {
					drive-strength = <0x03>;
					pinmux = <0x9701>;
				};
			};

			camera_pins_cam3_mclk_off {
				phandle = <0x6d>;

				pins_cmd_dat {
					drive-strength = <0x01>;
					pinmux = <0x9700>;
				};
			};

			camera_pins_cam4_mclk_2ma {
				phandle = <0x73>;

				pins_cmd_dat {
					drive-strength = <0x00>;
					pinmux = <0x9701>;
				};
			};

			camera_pins_cam4_mclk_4ma {
				phandle = <0x74>;

				pins_cmd_dat {
					drive-strength = <0x01>;
					pinmux = <0x9701>;
				};
			};

			camera_pins_cam4_mclk_6ma {
				phandle = <0x75>;

				pins_cmd_dat {
					drive-strength = <0x02>;
					pinmux = <0x9701>;
				};
			};

			camera_pins_cam4_mclk_8ma {
				phandle = <0x76>;

				pins_cmd_dat {
					drive-strength = <0x03>;
					pinmux = <0x9701>;
				};
			};

			camera_pins_cam4_mclk_off {
				phandle = <0x72>;

				pins_cmd_dat {
					drive-strength = <0x01>;
					pinmux = <0x9700>;
				};
			};
		};
	};

	fragment@67 {
		target = <0xffffffff>;

		__overlay__ {
			cam0_enable_sensor = "agates5khm2_mipi_raw agateov64b40_mipi_raw";
			cam0_vcamaf-supply = <0xffffffff>;
			cam0_vcamio-supply = <0xffffffff>;
			cam1_enable_sensor = "agateov16a1q_mipi_raw";
			cam1_vcamio-supply = <0xffffffff>;
			cam2_enable_sensor = "agates5k5e9_mipi_raw";
			cam2_vcama-supply = <0x32>;
			cam2_vcamaf-supply = <0xffffffff>;
			cam2_vcamd-supply = <0x31>;
			cam2_vcamio-supply = <0xffffffff>;
			cam3_enable_sensor = "agateimx355_mipi_raw";
			cam3_vcama-supply = <0x34>;
			cam3_vcamd-supply = <0x33>;
			cam3_vcamio-supply = <0xffffffff>;
			pinctrl-0 = <0x35>;
			pinctrl-1 = <0x36>;
			pinctrl-10 = <0x3f>;
			pinctrl-11 = <0x40>;
			pinctrl-12 = <0x41>;
			pinctrl-13 = <0x42>;
			pinctrl-14 = <0x43>;
			pinctrl-15 = <0x44>;
			pinctrl-16 = <0x45>;
			pinctrl-17 = <0x46>;
			pinctrl-18 = <0x47>;
			pinctrl-19 = <0x48>;
			pinctrl-2 = <0x37>;
			pinctrl-20 = <0x49>;
			pinctrl-21 = <0x4a>;
			pinctrl-22 = <0x4b>;
			pinctrl-23 = <0x4c>;
			pinctrl-24 = <0x4d>;
			pinctrl-25 = <0x4e>;
			pinctrl-26 = <0x4f>;
			pinctrl-27 = <0x50>;
			pinctrl-28 = <0x51>;
			pinctrl-29 = <0x52>;
			pinctrl-3 = <0x38>;
			pinctrl-30 = <0x53>;
			pinctrl-31 = <0x54>;
			pinctrl-32 = <0x55>;
			pinctrl-33 = <0x56>;
			pinctrl-34 = <0x57>;
			pinctrl-35 = <0x58>;
			pinctrl-36 = <0x59>;
			pinctrl-37 = <0x5a>;
			pinctrl-38 = <0x5b>;
			pinctrl-39 = <0x5c>;
			pinctrl-4 = <0x39>;
			pinctrl-40 = <0x5d>;
			pinctrl-41 = <0x5e>;
			pinctrl-42 = <0x5f>;
			pinctrl-43 = <0x60>;
			pinctrl-44 = <0x61>;
			pinctrl-45 = <0x62>;
			pinctrl-46 = <0x63>;
			pinctrl-47 = <0x64>;
			pinctrl-48 = <0x65>;
			pinctrl-49 = <0x66>;
			pinctrl-5 = <0x3a>;
			pinctrl-50 = <0x67>;
			pinctrl-51 = <0x68>;
			pinctrl-52 = <0x69>;
			pinctrl-53 = <0x6a>;
			pinctrl-54 = <0x6b>;
			pinctrl-55 = <0x6c>;
			pinctrl-56 = <0x6d>;
			pinctrl-57 = <0x6e>;
			pinctrl-58 = <0x6f>;
			pinctrl-59 = <0x70>;
			pinctrl-6 = <0x3b>;
			pinctrl-60 = <0x71>;
			pinctrl-61 = <0x72>;
			pinctrl-62 = <0x73>;
			pinctrl-63 = <0x74>;
			pinctrl-64 = <0x75>;
			pinctrl-65 = <0x76>;
			pinctrl-7 = <0x3c>;
			pinctrl-8 = <0x3d>;
			pinctrl-9 = <0x3e>;
			pinctrl-names = "default\0cam0_rst0\0cam0_rst1\0cam0_pnd0\0cam0_pnd1\0cam1_rst0\0cam1_rst1\0cam1_pnd0\0cam1_pnd1\0cam2_rst0\0cam2_rst1\0cam2_pnd0\0cam2_pnd1\0cam3_rst0\0cam3_rst1\0cam3_pnd0\0cam3_pnd1\0cam4_rst0\0cam4_rst1\0cam4_pnd0\0cam4_pnd1\0cam0_ldo_vcamd_0\0cam0_ldo_vcamd_1\0cam0_ldo_vcama_0\0cam0_ldo_vcama_1\0cam1_ldo_vcamd_0\0cam1_ldo_vcamd_1\0cam1_ldo_vcama_0\0cam1_ldo_vcama_1\0cam2_ldo_vcamd_0\0cam2_ldo_vcamd_1\0cam2_ldo_vcama_0\0cam2_ldo_vcama_1\0cam3_ldo_vcamd_0\0cam3_ldo_vcamd_1\0cam3_ldo_vcama_0\0cam3_ldo_vcama_1\0cam4_ldo_vcamd_0\0cam4_ldo_vcamd_1\0cam4_ldo_vcama_0\0cam4_ldo_vcama_1\0cam0_mclk_off\0cam0_mclk_2mA\0cam0_mclk_4mA\0cam0_mclk_6mA\0cam0_mclk_8mA\0cam1_mclk_off\0cam1_mclk_2mA\0cam1_mclk_4mA\0cam1_mclk_6mA\0cam1_mclk_8mA\0cam2_mclk_off\0cam2_mclk_2mA\0cam2_mclk_4mA\0cam2_mclk_6mA\0cam2_mclk_8mA\0cam3_mclk_off\0cam3_mclk_2mA\0cam3_mclk_4mA\0cam3_mclk_6mA\0cam3_mclk_8mA\0cam4_mclk_off\0cam4_mclk_2mA\0cam4_mclk_4mA\0cam4_mclk_6mA\0cam4_mclk_8mA";
			status = "okay";
		};
	};

	fragment@68 {
		target = <0xffffffff>;

		__overlay__ {

			camera_eeprom0@51 {
				compatible = "mediatek,camera_eeprom";
				phandle = <0xa1>;
				reg = <0x51>;
				status = "okay";
			};
		};
	};

	fragment@69 {
		target = <0xffffffff>;

		__overlay__ {

			camera_eeprom1@51 {
				compatible = "mediatek,camera_eeprom";
				phandle = <0xa2>;
				reg = <0x51>;
				status = "okay";
			};
		};
	};

	fragment@7 {
		target = <0xffffffff>;

		__overlay__ {
			pinctrl-0 = <0x01>;
			pinctrl-1 = <0x02>;
			pinctrl-2 = <0x03>;
			pinctrl-names = "lcm_rst_out1_gpio\0lcm_rst_out0_gpio\0mode_te_te";
			status = "okay";
		};
	};

	fragment@70 {
		target = <0xffffffff>;

		__overlay__ {

			camera_eeprom2@52 {
				compatible = "mediatek,camera_eeprom";
				phandle = <0xa3>;
				reg = <0x52>;
				status = "okay";
			};

			camera_eeprom3@50 {
				compatible = "mediatek,camera_eeprom";
				phandle = <0xa4>;
				reg = <0x50>;
				status = "okay";
			};
		};
	};

	fragment@71 {
		target = <0xffffffff>;

		__overlay__ {

			thermal-message {
				board-sensor = "VIRTUAL-SENSOR";
				phandle = <0xa5>;
			};
		};
	};

	fragment@72 {
		target = <0xffffffff>;

		__overlay__ {
			ac_charger_current = <0x16e360>;
			ac_charger_input_current = <0x16e360>;
			charging_host_charger_current = <0x16e360>;
			max_charger_voltage = <0xdd40a0>;
			non_std_ac_charger_current = <0xf4240>;
			pd_charger_current = <0x16e360>;
			ta_ac_charger_current = <0x16e360>;
			temp_t1_threshold = <0xfffffff6>;
			temp_t3_threshold = <0x00>;
			temp_t4_threshold = <0x3c>;
			usb_charger_current = <0x7a120>;
		};
	};

	fragment@73 {
		target = <0xffffffff>;

		__overlay__ {
			battery-67w;
		};
	};

	fragment@74 {
		target = <0xffffffff>;

		__overlay__ {
			ac_charger_current = <0x1e8480>;
			ac_charger_input_current = <0x1b7740>;
			algorithm_name = "SwitchCharging2";
			battery_67w;
			battery_cv = <0x440de0>;
			bc12_charger = <0x01>;
			charging_host_charger_current = <0x16e360>;
			current_a = <0x895440>;
			current_b = <0x7026f0>;
			current_c = <0x6132d0>;
			current_d = <0x4ac4a0>;
			current_max = <0xbd3580>;
			enable_cv_step;
			enable_ffc;
			enable_min_charge_temp;
			enable_sw_jeita;
			enable_vote;
			ffc_cv = <0x448310>;
			ffc_ieoc = <0x113258>;
			ffc_ieoc_b = <0x15aec8>;
			jeita_temp_above_t4_cv = <0x3e8fa0>;
			jeita_temp_below_t0_cv = <0x401640>;
			jeita_temp_t0_to_t1_cv = <0x43e6d0>;
			jeita_temp_t1_to_t1p5_cv = <0x43e6d0>;
			jeita_temp_t1p5_to_t2_cv = <0x43e6d0>;
			jeita_temp_t2_to_t3_cv = <0x43e6d0>;
			jeita_temp_t3_to_t4_cv = <0x3e8fa0>;
			jeita_temp_tn1_to_t0_cv_a = <0x401640>;
			jeita_temp_tn1_to_t0_cv_b = <0x43e6d0>;
			max_charge_temp = <0x3c>;
			max_charge_temp_minus_x_degree = <0x3a>;
			max_charger_voltage = <0xdd40a0>;
			max_dmivr_charger_current = <0x155cc0>;
			min_charge_temp = <0x00>;
			min_charge_temp_plus_x_degree = <0x02>;
			min_charger_voltage = <0x44aa20>;
			min_charger_voltage_1 = <0x432380>;
			min_charger_voltage_2 = <0x401640>;
			non_ffc_cv = <0x43e6d0>;
			non_ffc_ieoc = <0x30d40>;
			non_std_ac_charger_current = <0xf4240>;
			pd_vbus_upper_bound = <0x895440>;
			qcom,thermal-mitigation-dcp = <0x186a00 0x186a00 0x186a00 0x186a00 0x186a00 0x186a00 0x186a00 0x186a00 0x186a00 0x186a00 0x186a00 0x186a00 0x16e360 0x155cc0 0x124f80 0xf4240>;
			qcom,thermal-mitigation-pd-base = <0xbd3580 0xa7d8c0 0x9402a0 0x864700 0x7a1200 0x7270e0 0x6acfc0 0x67c280 0x632ea0 0x5b8d80 0x4c4b40 0x3d0900 0x2dc6c0 0x1e8480 0xf4240 0x7a120>;
			qcom,thermal-mitigation-qc2 = <0x16e360 0x16e360 0x16e360 0x16e360 0x16e360 0x16e360 0x155cc0 0x13d620 0x124f80 0x10c8e0 0xf4240 0xdbba0 0xc3500 0xaae60 0x927c0 0x7a120>;
			qcom,thermal-mitigation-qc3 = <0x3567e0 0x3567e0 0x3567e0 0x33e140 0x325aa0 0x325aa0 0x30d400 0x2f4d60 0x2dc6c0 0x2ab980 0x27ac40 0x249f00 0x2191c0 0x1e8480 0xf4240 0xaae60>;
			qcom,thermal-mitigation-qc3-classb = <0x5265c0 0x4dd1e0 0x47b760 0x419ce0 0x3d0900 0x36ee80 0x33e140 0x33e140 0x33e140 0x30d400 0x2625a0 0x2191c0 0x1e8480 0x13d620 0xf4240 0xaae60>;
			qcom,thermal-mitigation-qc3p5 = <0x44aa20 0x401640 0x3d0900 0x39fbc0 0x36ee80 0x33e140 0x30d400 0x2f4d60 0x2dc6c0 0x2ab980 0x27ac40 0x249f00 0x2191c0 0x1e8480 0xf4240 0xaae60>;
			step_a = <0x3dcc50>;
			step_b = <0x3f52f0>;
			step_c = <0x426030>;
			step_d = <0x43e6d0>;
			step_hy_down_a = <0x249f0>;
			step_hy_down_b = <0x249f0>;
			step_hy_down_c = <0x249f0>;
			step_hy_down_d = <0x249f0>;
			temp_neg_10_thres = <0xfffffff6>;
			temp_t0_thres = <0x00>;
			temp_t0_thres_plus_x_degree = <0x01>;
			temp_t0_to_t1_fcc = <0x256250>;
			temp_t1_thres = <0x05>;
			temp_t1_thres_plus_x_degree = <0x06>;
			temp_t1_to_t1p5_fcc = <0x345670>;
			temp_t1p5_thres = <0x0a>;
			temp_t1p5_thres_plus_x_degree = <0x0b>;
			temp_t1p5_to_t2_fcc = <0x59b8c0>;
			temp_t2_thres = <0x0f>;
			temp_t2_thres_plus_x_degree = <0x11>;
			temp_t2_to_t3_fcc = <0xbd3580>;
			temp_t3_thres = <0x30>;
			temp_t3_thres_minus_x_degree = <0x2f>;
			temp_t3_to_t4_fcc = <0x256250>;
			temp_t4_thres = <0x3c>;
			temp_t4_thres_minus_x_degree = <0x3a>;
			temp_tn1_thres = <0xfffffff6>;
			temp_tn1_thres_plus_x_degree = <0xfffffff7>;
			temp_tn1_to_t0_fcc_a = <0xf4240>;
			temp_tn1_to_t0_fcc_b = <0xb3718>;
			use_xmusb350_do_apsd;
			xm_pps_dual_charger_chg1_current = <0x7a120>;
			xm_pps_dual_charger_chg2_current = <0x2625a0>;
			xm_pps_dual_charger_input_current = <0x2dc6c0>;
			xm_pps_max_ibus = <0x2dc6c0>;
			xm_pps_max_vbus = <0xb71b00>;
			xm_pps_single_charger_current = <0x5b8d80>;
			xm_pps_single_charger_current_non_verified_pps = "\0I>";
			xm_pps_single_charger_input_current = <0x2dc6c0>;
		};
	};

	fragment@75 {
		target = <0xffffffff>;

		__overlay__ {

			chg {
				cv = <0x43e6d0>;
				en_eoc = <0x01>;
				en_te = <0x01>;
				ieoc = <0x30d40>;
				ircmp_resistor = <0x00>;
				ircmp_vclamp = <0x00>;
			};

			core {
				sda_drvsrsel = <0x01>;
				sda_sizesel = <0x03>;
			};
		};
	};

	fragment@76 {
		target = <0xffffffff>;

		__overlay__ {
			DISABLE_MTKBATTERY = <0x01>;
			battery-67w;
			use-ti-gauge;
		};
	};

	fragment@77 {
		target = <0xffffffff>;

		__overlay__ {

			bq2597x_master_int_default {
				phandle = <0x7d>;

				pins_cmd_dat {
					bias-pull-up = <0x0b>;
					pinmux = <0x1000>;
					slew-rate = <0x00>;
				};
			};

			bq2597x_master_int_suspend {
				phandle = <0x7e>;

				pins_cmd_dat {
					bias-pull-up = <0x0b>;
					pinmux = <0x1000>;
					slew-rate = <0x00>;
				};
			};

			bq2597x_slave_int_default {
				phandle = <0x7f>;

				pins_cmd_dat {
					bias-pull-up = <0x0b>;
					pinmux = <0x1300>;
					slew-rate = <0x00>;
				};
			};

			bq2597x_slave_int_suspend {
				phandle = <0x80>;

				pins_cmd_dat {
					bias-pull-up = <0x0b>;
					pinmux = <0x1300>;
					slew-rate = <0x00>;
				};
			};

			xmusb350_int_isp {
				phandle = <0xa7>;

				pins_cmd_dat {
					bias-pull-up = <0x0b>;
					input-enable;
					pinmux = <0x6e00>;
					slew-rate = <0x00>;
				};
			};

			xmusb350_int_normal {
				phandle = <0xa6>;

				pins_cmd_dat {
					bias-pull-up = <0x0b>;
					input-enable;
					pinmux = <0x6e00>;
					slew-rate = <0x00>;
				};
			};

			xmusb350_rst_isp {
				phandle = <0x7a>;

				pins_cmd_dat {
					bias-disable;
					output-low;
					pinmux = <0x1c00>;
					slew-rate = <0x01>;
				};
			};

			xmusb350_rst_normal {
				phandle = <0x77>;

				pins_cmd_dat {
					bias-disable;
					output-low;
					pinmux = <0x1c00>;
					slew-rate = <0x01>;
				};
			};

			xmusb350_scl_isp {
				phandle = <0x7c>;

				pins_cmd_dat {
					bias-disable;
					output-low;
					pinmux = <0xcc00>;
					slew-rate = <0x01>;
				};
			};

			xmusb350_scl_normal {
				phandle = <0x79>;

				pins_cmd_dat {
					bias-pull-up = <0x0b>;
					input-enable;
					pinmux = <0xcc01>;
					slew-rate = <0x00>;
				};
			};

			xmusb350_sda_isp {
				phandle = <0x7b>;

				pins_cmd_dat {
					bias-disable;
					output-low;
					pinmux = <0xcd00>;
					slew-rate = <0x01>;
				};
			};

			xmusb350_sda_normal {
				phandle = <0x78>;

				pins_cmd_dat {
					bias-pull-up = <0x0b>;
					input-enable;
					pinmux = <0xcd01>;
					slew-rate = <0x00>;
				};
			};
		};
	};

	fragment@78 {
		target = <0xffffffff>;

		__overlay__ {
			clock-frequency = <0x186a0>;

			bq27z561_i2c0@55 {
				bq,battery-67w;
				bq,charge-full-design = <0x4c4b40>;
				bq,cold_thermal_seq = <0x01 0x00 0x64 0x6a4 0x02 0xfffffed4 0x00 0x3e8>;
				bq,ignore-digest-debug;
				bq,recharge-voltage = <0x111c>;
				bq,shutdown-delay-enable;
				bq,soc_decimal_rate = <0x00 0x26 0x0a 0x23 0x14 0x21 0x1e 0x21 0x28 0x21 0x32 0x21 0x3c 0x21 0x46 0x1e 0x50 0x19 0x5a 0x14 0x5f 0x0a>;
				compatible = "ti,bq27z561_i2c0";
				reg = <0x55>;
			};

			xmusb350-charger@35 {
				alias_name = "xmusb350";
				charger_name = "secondary_chg";
				compatible = "xm,xmusb350-charger";
				en_bc12;
				en_hvdcp;
				en_intb;
				en_sleep;
				interrupt-parent = <0xffffffff>;
				interrupts = <0x6e 0x02 0x6e 0x00>;
				mi,connect_therm = <0xffffffff 0x1d 0x00>;
				pinctrl-0 = <0x77 0x78 0x79>;
				pinctrl-1 = <0x7a 0x7b 0x7c>;
				pinctrl-names = "xmusb350_normal\0xmusb350_isp";
				reg = <0x35>;
				xm,xmusb350_rst_gpio = <0xffffffff 0x1c 0x00>;
				xm,xmusb350_scl_gpio = <0xffffffff 0xcc 0x00>;
				xm,xmusb350_sda_gpio = <0xffffffff 0xcd 0x00>;
			};
		};
	};

	fragment@79 {
		target = <0xffffffff>;

		__overlay__ {
			clock-frequency = <0x61a80>;

			bq27z561_i2c9@55 {
				bq,battery-67w;
				bq,charge-full-design = <0x4c4b40>;
				bq,cold_thermal_seq = <0x01 0x00 0x64 0x6a4 0x02 0xfffffed4 0x00 0x3e8>;
				bq,ignore-digest-debug;
				bq,recharge-voltage = <0x111c>;
				bq,shutdown-delay-enable;
				bq,soc_decimal_rate = <0x00 0x26 0x0a 0x23 0x14 0x21 0x1e 0x21 0x28 0x21 0x32 0x21 0x3c 0x21 0x46 0x1e 0x50 0x19 0x5a 0x14 0x5f 0x0a>;
				compatible = "ti,bq27z561_i2c9";
				reg = <0x55>;
			};
		};
	};

	fragment@8 {
		target = <0xffffffff>;

		__overlay__ {
			pinctrl-0 = <0x01>;
			pinctrl-1 = <0x02>;
			pinctrl-2 = <0x03>;
			pinctrl-names = "lcm_rst_out1_gpio\0lcm_rst_out0_gpio\0mode_te_te";
			status = "okay";
		};
	};

	fragment@80 {
		target = <0xffffffff>;

		__overlay__ {
			clock-frequency = <0x61a80>;

			bq2597x-master@65 {
				charger_name = "tertiary_chg";
				compatible = "ti,bq2597x-master";
				interrupt-parent = <0xffffffff>;
				interrupts = <0x10 0x02 0x10 0x00>;
				pinctrl-0 = <0x7d 0x7e>;
				pinctrl-names = "bq2597x_master_irq";
				reg = <0x65>;
				sc8551,ac-ovp-threshold = <0x0d>;
				sc8551,bypass-enable;
				sc8551a,dual-stdalone-scheme;
				ti,bq2597x,ac-ovp-threshold = <0x0e>;
				ti,bq2597x,bat-ocp-alarm-threshold = <0x1770>;
				ti,bq2597x,bat-ocp-threshold = <0x1b58>;
				ti,bq2597x,bat-ovp-alarm-disable;
				ti,bq2597x,bat-ovp-alarm-threshold = <0x1211>;
				ti,bq2597x,bat-ovp-threshold = <0x122a>;
				ti,bq2597x,bat-therm-disable;
				ti,bq2597x,bat-therm-threshold = <0x15>;
				ti,bq2597x,bat-ucp-alarm-disable;
				ti,bq2597x,bat-ucp-disable;
				ti,bq2597x,bus-ocp-alarm-threshold = <0xdac>;
				ti,bq2597x,bus-ocp-threshold = <0xea6>;
				ti,bq2597x,bus-ovp-alarm-threshold = <0x2af8>;
				ti,bq2597x,bus-ovp-threshold = <0x2ee0>;
				ti,bq2597x,bus-therm-disable;
				ti,bq2597x,bus-therm-threshold = <0x15>;
				ti,bq2597x,die-therm-disable;
				ti,bq2597x,die-therm-threshold = <0x91>;
			};

			bq2597x-slave@66 {
				charger_name = "quaternary_chg";
				compatible = "ti,bq2597x-slave";
				interrupt-parent = <0xffffffff>;
				interrupts = <0x13 0x02 0x13 0x00>;
				pinctrl-0 = <0x7f 0x80>;
				pinctrl-names = "bq2597x_slave_irq";
				reg = <0x66>;
				sc8551,ac-ovp-threshold = <0x0d>;
				sc8551,bypass-enable;
				sc8551a,dual-stdalone-scheme;
				ti,bq2597x,ac-ovp-threshold = <0x0e>;
				ti,bq2597x,bat-ocp-alarm-threshold = <0x1770>;
				ti,bq2597x,bat-ocp-threshold = <0x1b58>;
				ti,bq2597x,bat-ovp-alarm-disable;
				ti,bq2597x,bat-ovp-alarm-threshold = <0x1211>;
				ti,bq2597x,bat-ovp-threshold = <0x122a>;
				ti,bq2597x,bat-therm-disable;
				ti,bq2597x,bat-therm-threshold = <0x15>;
				ti,bq2597x,bat-ucp-alarm-disable;
				ti,bq2597x,bat-ucp-disable;
				ti,bq2597x,bus-ocp-alarm-threshold = <0xdac>;
				ti,bq2597x,bus-ocp-threshold = <0xea6>;
				ti,bq2597x,bus-ovp-alarm-threshold = <0x2af8>;
				ti,bq2597x,bus-ovp-threshold = <0x2ee0>;
				ti,bq2597x,bus-therm-disable;
				ti,bq2597x,bus-therm-threshold = <0x15>;
				ti,bq2597x,die-therm-disable;
				ti,bq2597x,die-therm-threshold = <0x91>;
			};

			ln8000-master@5B {
				charger_name = "tertiary_chg";
				compatible = "lionsemi,ln8000-master";
				interrupt-parent = <0xffffffff>;
				interrupts = <0x10 0x02 0x10 0x00>;
				ln8000_charger,bat-ovp-alarm-threshold = <0x1211>;
				ln8000_charger,bat-ovp-threshold = <0x1234>;
				ln8000_charger,bus-ocp-alarm-threshold = <0xdac>;
				ln8000_charger,bus-ocp-threshold = <0xea6>;
				ln8000_charger,bus-ovp-alarm-threshold = <0x2af8>;
				ln8000_charger,bus-ovp-threshold = <0x32c8>;
				ln8000_charger,iin-ocp-disable;
				ln8000_charger,iin-reg-disable;
				ln8000_charger,ntc-alarm-cfg = <0xe2>;
				ln8000_charger,tbat-mon-disable;
				ln8000_charger,tbus-mon-disable;
				ln8000_charger,tdie-prot-disable;
				ln8000_charger,tdie-reg-disable;
				ln8000_charger,vbat-reg-disable;
				pinctrl-0 = <0x7d 0x7e>;
				pinctrl-names = "bq2597x_master_irq";
				reg = <0x5b>;
			};

			ln8000-slave@51 {
				charger_name = "quaternary_chg";
				compatible = "lionsemi,ln8000-slave";
				interrupt-parent = <0xffffffff>;
				interrupts = <0x13 0x02 0x13 0x00>;
				ln8000_charger,bat-ovp-alarm-threshold = <0x1211>;
				ln8000_charger,bat-ovp-threshold = <0x1234>;
				ln8000_charger,bus-ocp-alarm-threshold = <0xdac>;
				ln8000_charger,bus-ocp-threshold = <0xea6>;
				ln8000_charger,bus-ovp-alarm-threshold = <0x2af8>;
				ln8000_charger,bus-ovp-threshold = <0x32c8>;
				ln8000_charger,iin-ocp-disable;
				ln8000_charger,iin-reg-disable;
				ln8000_charger,ntc-alarm-cfg = <0xe2>;
				ln8000_charger,tbat-mon-disable;
				ln8000_charger,tbus-mon-disable;
				ln8000_charger,tdie-prot-disable;
				ln8000_charger,tdie-reg-disable;
				ln8000_charger,vbat-reg-disable;
				pinctrl-0 = <0x7f 0x80>;
				pinctrl-names = "bq2597x_slave_irq";
				reg = <0x51>;
			};
		};
	};

	fragment@81 {
		target = <0xffffffff>;

		__overlay__ {
			compatible = "xiaomi,cp-qc30";
			mi,cp-sec-enable;
			mi,qc3-27w-bat-curr-max = <0x1518>;
			mi,qc3-27w-bus-curr-max = <0x992>;
			mi,qc3-bat-curr-max = <0xe10>;
			mi,qc3-bat-volt-max = <0x1180>;
			mi,qc3-bus-curr-max = <0x834>;
			mi,qc3-bus-volt-max = <0x2ee0>;
			mi,qc3-non-ffc-bat-volt-max = <0x1162>;
			mi,qc3p-bat-curr-max = <0x1194>;
			mi,qc3p-bus-curr-max = <0x8ca>;
			status = "okay";
		};
	};

	fragment@82 {
		target = <0xffffffff>;

		__overlay__ {
			battery-67w;
			compatible = "xiaomi,usbpd-pm";
			mi,cp-sec-enable;
			mi,pd-bat-curr-max = <0x3070>;
			mi,pd-bat-volt-max = <0x1180>;
			mi,pd-bus-curr-max = <0x1838>;
			mi,pd-bus-volt-max = <0x2ee0>;
			mi,pd-non-ffc-bat-volt-max = <0x1162>;
			mi,pd-power-max = <0x43>;
			status = "okay";
		};
	};

	fragment@83 {
		target = <0xffffffff>;

		__overlay__ {

			usb_phy_tuning {
				compatible = "mediatek,phy_tuning";
				u2_discth = <0x0f>;
				u2_enhance = <0x03>;
				u2_intr_cal = <0x12>;
				u2_term_ref = <0x06>;
				u2_vrt_ref = <0x06>;
			};
		};
	};

	fragment@84 {
		target = <0xffffffff>;

		__overlay__ {

			willsemi,ldo@28 {
				compatible = "willsemi,wl2866d1";
				index = <0x00>;
				phandle = <0xa8>;
				reg = <0x28>;

				on,wl2866d1@0 {
					init-voltage = <0x100590>;
					iout_ua = <0x7a120>;
					min-dropout-voltage = <0x13880>;
					offset = [00 00];
					phandle = <0x31>;
					regulator-max-microvolt = <0x1b7740>;
					regulator-min-microvolt = <0x927c0>;
					regulator-name = "wl2866d-dvdd1";
				};

				on,wl2866d1@1 {
					init-voltage = <0x1339e0>;
					iout_ua = <0x7a120>;
					min-dropout-voltage = <0x13880>;
					offset = [00 01];
					phandle = <0x33>;
					regulator-max-microvolt = <0x1b7740>;
					regulator-min-microvolt = <0x927c0>;
					regulator-name = "wl2866d-dvdd2";
				};

				on,wl2866d1@2 {
					init-voltage = <0x2ab980>;
					iout_ua = <0x493e0>;
					min-dropout-voltage = <0x15f90>;
					offset = [00 02];
					phandle = <0x32>;
					regulator-max-microvolt = <0x419ce0>;
					regulator-min-microvolt = <0x124f80>;
					regulator-name = "wl2866d-avdd1";
				};

				on,wl2866d1@3 {
					init-voltage = <0x2ab980>;
					iout_ua = <0x493e0>;
					min-dropout-voltage = <0x15f90>;
					offset = [00 03];
					phandle = <0x34>;
					regulator-max-microvolt = <0x419ce0>;
					regulator-min-microvolt = <0x124f80>;
					regulator-name = "wl2866d-avdd2";
				};
			};
		};
	};

	fragment@85 {
		target = <0xffffffff>;

		__overlay__ {

			testing-mode {
				compatible = "modem,testing-mode";
				debounce-time = <0x1e>;
				pinctrl-0 = <0x81>;
				pinctrl-names = "default";
				status-gpio = <0xffffffff 0x38 0x00>;
			};
		};
	};

	fragment@86 {
		target = <0xffffffff>;

		__overlay__ {

			test_mode_irq56 {
				phandle = <0x81>;

				pins_cmd_dat {
					bias-disable;
					drive-strength = <0x02>;
					input-enable;
					pinmux = <0x3800>;
				};
			};
		};
	};

	fragment@87 {
		target = <0xffffffff>;

		__overlay__ {
			interrupts = <0x12 0x04 0x01 0x00>;
		};
	};

	fragment@88 {
		target = <0xffffffff>;

		__overlay__ {
			status = "disabled";
		};
	};

	fragment@89 {
		target = <0xffffffff>;

		__overlay__ {
			status = "disabled";
		};
	};

	fragment@9 {
		target = <0xffffffff>;

		__overlay__ {
			accdet-mic-mode = <0x02>;
			accdet-mic-vol = <0x08>;
			accdet-plugout-debounce = <0x01>;
			eint_use_ext_res = <0x00>;
			headset-four-key-threshold = <0x00 0x3a 0x79 0xc0 0x190>;
			headset-mode-setting = <0x500 0x500 0x01 0x1f0 0x800 0x800 0x20 0x44 0x04 0x01 0x05 0x03 0x03 0x05 0x0e>;
			headset-three-key-threshold = <0x00 0x50 0xdc 0x190>;
			headset-three-key-threshold-CDD = <0x00 0x79 0xc0 0x258>;
			status = "okay";
		};
	};

	fragment@90 {
		target = <0xffffffff>;

		__overlay__ {

			lcm_err_flag {
				phandle = <0x82>;

				pins_cmd_dat {
					bias-disable;
					pinmux = <0x8400>;
					slew-rate = <0x00>;
				};
			};
		};
	};

	fragment@91 {
		target = <0xffffffff>;

		__overlay__ {
			pinctrl-0 = <0x01>;
			pinctrl-1 = <0x02>;
			pinctrl-2 = <0x03>;
			pinctrl-3 = <0x82>;
			pinctrl-names = "lcm_rst_out1_gpio\0lcm_rst_out0_gpio\0mode_te_te\0err_flag_init";
			status = "okay";
		};
	};

	fragment@92 {
		target = <0xffffffff>;

		__overlay__ {
			pinctrl-0 = <0x01>;
			pinctrl-1 = <0x02>;
			pinctrl-2 = <0x03>;
			pinctrl-3 = <0x82>;
			pinctrl-names = "lcm_rst_out1_gpio\0lcm_rst_out0_gpio\0mode_te_te\0err_flag_init";
			status = "okay";
		};
	};

	fragment@93 {
		target = <0xffffffff>;

		__overlay__ {
			#address-cells = <0x01>;
			#size-cells = <0x00>;
			status = "okay";

			panel1@0 {
				compatible = "k11t_42_02_0a_dsc_cmd,lcm";
				dvdd-gpios = <0xffffffff 0x66 0x00>;
				mi,esd-err-irq-gpio = <0xffffffff 0x84 0x2002>;
				pinctrl-names = "default";
				reg = <0x00>;
				reset-gpios = <0xffffffff 0x2a 0x00>;
				te-gpios = <0xffffffff 0x29 0x00>;

				port {

					endpoint {
						phandle = <0x84>;
						remote-endpoint = <0x83>;
					};
				};
			};

			ports {

				port {

					endpoint {
						phandle = <0x83>;
						remote-endpoint = <0x84>;
					};
				};
			};
		};
	};
};
